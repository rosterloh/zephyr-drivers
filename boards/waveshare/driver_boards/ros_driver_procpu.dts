/dts-v1/;

#include <espressif/esp32/esp32.dtsi>
#include <espressif/partitions_0x1000_amp_4M.dtsi>
#include "ros_driver-pinctrl.dtsi"
/* Before the common dtsi, so grove_header0 keeps its position among the root
 * node's children and the generated DT_N_S_..._CHILD_IDX values do not move. */
#include "grove_connectors.dtsi"
#include "waveshare_driver_common.dtsi"

/ {
	model = "Waveshare ROS Driver for Robotics PROCPU";
};

/* 4MB flash on the WROOM-32UE-N4; the SoC dtsi no longer sets reg or ranges.
 * Partitions come from partitions_0x1000_amp_4M.dtsi, included above.
 */
&flash0 {
	reg = <0x0 DT_SIZE_M(4)>;
	ranges = <0x0 0x0 DT_SIZE_M(4)>;
	status = "okay";
};

&i2c0 {
	/* ICM-20948 9-axis IMU. This board carries the ICM-20948 where
	 * robot_driver carries a QMI8658C + AK09918C pair, so the two are not
	 * interchangeable in an application: different driver, different register
	 * map, different magnetometer arrangement.
	 *
	 * Address 0x68 (AD0 low) confirmed 2026-08-28 by `i2c scan
	 * i2c@3ff53000` on a bench unit, which answered at 0x3c, 0x42 and 0x68
	 * and nothing else. Note the absence of 0x0c: the AK09916 magnetometer
	 * is behind this part's own I2C master, not on the host bus, which is
	 * why the driver does not expose it. */
	icm20948: icm20948@68 {
		compatible = "invensense,icm20948";
		reg = <0x68>;
	};
};
