## boards/waveshare/esp32p4_wifi6_poe_eth/board.yml
```yaml
# Copyright (c) 2026 Richard Osterloh
# SPDX-License-Identifier: Apache-2.0

board:
  name: esp32p4_wifi6_poe_eth
  full_name: ESP32-P4-WIFI6-POE-ETH
  vendor: waveshare
  socs:
  - name: esp32p4
```

## drivers/actuator/icl57/Kconfig
```kconfig
config ACTUATOR_ICL57
	bool "iCL-RS integrated closed-loop stepper actuator (Modbus RTU)"
	depends on ACTUATOR
	depends on DT_HAS_ROSTERLOH_ACTUATOR_ICL57_ENABLED
	select MODBUS
	select UART_INTERRUPT_DRIVEN
	default y
	help
	  StepperOnline/Leadshine iCL-RS series integrated closed-loop stepper
	  motors over RS485 Modbus RTU. Each instance is a child of a
	  zephyr,modbus-serial bus node; the driver binds to the parent Modbus
	  interface by name and streams absolute position setpoints via the PR0
	  immediate-trigger block.

config ACTUATOR_ICL57_MAPPED_POLL
	bool "Poll feedback through the drive's register-mapping block"
	depends on ACTUATOR_ICL57
	default y
	help
	  Program the iCL-RS register-mapping area (manual section 4.5) at every
	  enable so one FC03 returns motion state, feedback position, feedback
	  velocity and the digital inputs, instead of three transactions per
	  poll plus one DI read per setpoint. Roughly a 4x cut in bus traffic on
	  a three-motor bus, which is the documented cause of mispaired reads.

	  On iCL57-RS13 drives the values read back at 0x0F00 (the manual's
	  worked example; its prose says 0x0F10, which reads back the TARGET
	  addresses). The driver probes both addresses and
	  trusts the block only once its mapped Pr0.00 word reads back as
	  counts-per-rev; if neither passes it logs a warning and keeps the
	  direct reads, so enabling this cannot silently change what feeds the
	  setpoint path.

	  On by default: homing and position-mode moves across ~50 low-word wraps
	  of the mapped 32-bit position showed no tearing, and bus load on a
	  three-drive bus fell from ~75 to 28-32 transactions a second.

config ACTUATOR_ICL57_BUS_STATS
	bool "Log a per-second summary of Modbus traffic"
	depends on ACTUATOR_ICL57
	help
	  One INF line a second: transactions, failures, how many took over
	  30 ms, the slowest, and the longest gap between two setpoint writes to
	  any drive, plus one line per failed or slow transaction: the way to
	  tell a motion stall from a bus timeout. Separate from debug logging on
	  purpose: debug logging floods the log, which drops lines under load,
	  and a summary covers its whole second even when other lines are lost.
```

## drivers/ethercat/Kconfig
```kconfig
# Copyright (c) 2026 Richard Osterloh
# SPDX-License-Identifier: Apache-2.0

menu "EtherCAT drivers"

rsource "Kconfig.lan9252"

endmenu
```

## drivers/ethercat/Kconfig.lan9252
```kconfig
# Copyright (c) 2026 Richard Osterloh
# SPDX-License-Identifier: Apache-2.0

config LAN9252
	bool "Microchip LAN9252 EtherCAT SubDevice controller"
	default y
	depends on DT_HAS_MICROCHIP_LAN9252_ENABLED
	depends on SPI
	select GPIO if ($(dt_compat_any_has_prop,$(DT_COMPAT_MICROCHIP_LAN9252),reset-gpios) || \
			$(dt_compat_any_has_prop,$(DT_COMPAT_MICROCHIP_LAN9252),int-gpios))
	help
	  Enable the SPI host driver for the Microchip LAN9252 EtherCAT
	  SubDevice controller. The driver exposes direct System CSR access and
	  indirect EtherCAT Core CSR access; it does not register an Ethernet
	  network interface.

module = LAN9252
module-str = lan9252
source "subsys/logging/Kconfig.template.log_config"
```

## drivers/ethernet/Kconfig
```kconfig
# Copyright (c) 2026 Richard Osterloh
# SPDX-License-Identifier: Apache-2.0

menu "Ethernet switch drivers"

rsource "Kconfig.adin3310"

endmenu
```

## drivers/ethernet/Kconfig.adin3310
```kconfig
# Copyright (c) 2026 Richard Osterloh
# SPDX-License-Identifier: Apache-2.0

config ADIN3310
	bool "Analog Devices ADIN3310 Ethernet switch management"
	default y
	depends on DT_HAS_ADI_ADIN3310_ENABLED
	depends on SPI
	select GPIO if ($(dt_compat_any_has_prop,$(DT_COMPAT_ADI_ADIN3310),reset-gpios) || \
			$(dt_compat_any_has_prop,$(DT_COMPAT_ADI_ADIN3310),int-gpios))
	help
	  Enable the SPI host management driver for the Analog Devices
	  ADIN3310 3-port Industrial Ethernet TSN switch. The driver exposes
	  reset handling and a raw SPI management transfer API for the ADI
	  ADINx310 host/SES porting layer; it does not register an Ethernet
	  network interface or DSA switch ports.

module = ADIN3310
module-str = adin3310
source "subsys/logging/Kconfig.template.log_config"
```

## drivers/sensor/icm20948/Kconfig
```kconfig
# ICM-20948 9-axis IMU configuration option

config ICM20948_OOT
	bool "TDK InvenSense ICM-20948 IMU over I2C (out-of-tree)"
	default y
	depends on DT_HAS_INVENSENSE_ICM20948_ENABLED
	depends on !ICM20948
	select I2C
	help
	  Enable this repository's driver for the ICM-20948 accelerometer and
	  gyroscope over I2C. The on-chip AK09916 magnetometer is not exposed;
	  it sits behind the part's own I2C master and nothing needs it yet.

	  Zephyr's in-tree driver (CONFIG_ICM20948) binds the same
	  "invensense,icm20948" compatible but supports SPI only, and builds
	  for every instance, so set CONFIG_ICM20948=n to use this one.
```

## drivers/sensor/ina3221/Kconfig
```kconfig
# Copyright (c) 2026 Richard Osterloh
# SPDX-License-Identifier: Apache-2.0

config INA3221_OOT
	bool "TI INA3221 (out-of-tree fork with read/decode support)"
	depends on DT_HAS_TI_INA3221_ENABLED
	depends on !INA3221
	select I2C
	help
	  Use this repository's fork of Zephyr's drivers/sensor/ti/ina3221,
	  which adds the read/decode (RTIO) sensor API when
	  CONFIG_SENSOR_ASYNC_API is enabled: one sensor_read() measures all
	  three channels, and the decoder reports each rail by chan_idx (0-2)
	  for SENSOR_CHAN_VOLTAGE, SENSOR_CHAN_CURRENT and SENSOR_CHAN_POWER.

	  Both bind the "ti,ina3221" compatible, so set CONFIG_INA3221=n to
	  enable this. The fetch/get API and SENSOR_ATTR_INA3221_SELECTED_CHANNEL
	  behave as in-tree.
```

## drivers/sensor/ltr308/Kconfig
```kconfig
# Copyright (c) 2026 Richard Osterloh
# SPDX-License-Identifier: Apache-2.0

config LTR308
	bool "Lite-On LTR-308 ambient light sensor"
	default y
	depends on DT_HAS_LITEON_LTR308_ENABLED
	select I2C
	help
	  LTR-308ALS-01 ambient light sensor, read as SENSOR_CHAN_LIGHT
	  (lux). Zephyr has no in-tree driver.
```

## drivers/video/Kconfig
```kconfig
# Copyright (c) 2026 Richard Osterloh
# SPDX-License-Identifier: Apache-2.0

config VIDEO_IMX219_OOT
	bool "Sony IMX219 (out-of-tree fork)"
	select I2C
	depends on DT_HAS_SONY_IMX219_ENABLED
	help
	  Use this repository's fork of the IMX219 driver instead of Zephyr's
	  in-tree drivers/video/imx219.c, to correct the sensor's PLL programming
	  against Raspberry Pi's kernel driver.

	  Both bind the "sony,imx219" compatible, so set CONFIG_VIDEO_IMX219=n
	  when enabling this, or the build will define the same device twice.

config VIDEO_OV5647
	bool "OmniVision OV5647 (Raspberry Pi Camera Module v1)"
	default y
	select I2C
	depends on DT_HAS_OVTI_OV5647_ENABLED
	help
	  Enable the OV5647 MIPI CSI-2 image sensor driver. Zephyr has no in-tree
	  OV5647 driver, so unlike the IMX219 above there is no symbol to turn off
	  alongside this one.

	  Implements the 800x640 and 800x800 RAW8 50 fps modes, ported from
	  Espressif's esp_cam_sensor component and both verified streaming on
	  hardware. Frames are Bayer GBRG - nothing in Zephyr's ESP32-P4 CSI path
	  demosaics them, so an application gets raw Bayer and must debayer itself.

	  RAW10 is not offered: it needs the ESP32-P4 ISP's bypass path, which does
	  not deliver complete frames (see the comment in ov5647.c).

config VIDEO_ESP32_CSI
	bool "ESP32-P4 MIPI CSI-2 camera receiver"
	default y
	depends on DT_HAS_ESPRESSIF_ESP32P4_MIPI_CSI_ENABLED
	depends on SOC_SERIES_ESP32P4
	help
	  Enable the ESP32-P4 MIPI CSI-2 receiver video-capture driver. It drives
	  the CSI D-PHY, host and bridge, and a DW-GDMA channel that streams frames
	  from a downstream CSI-2 image sensor (e.g. Sony IMX219) into memory.
	  Uses the video subsystem log level (CONFIG_VIDEO_LOG_LEVEL).

config VIDEO_ARDUCAM_PIVARIETY
	bool "Arducam Pivariety camera"
	default y
	select I2C
	depends on DT_HAS_ARDUCAM_PIVARIETY_ENABLED
	help
	  Enable the Arducam Pivariety camera driver. Pivariety modules carry an
	  on-board MCU that describes the module's formats, resolutions and
	  controls over I2C, so this one driver serves every camera in the family
	  (including the Arducam ToF depth camera) without per-sensor register
	  tables.

	  Frames are delivered raw. Any depth or Bayer processing is the
	  application's problem.

config VIDEO_ARDUCAM_PIVARIETY_MAX_FORMATS
	int "Maximum enumerated (format, resolution) pairs"
	default 16
	depends on VIDEO_ARDUCAM_PIVARIETY
	help
	  Upper bound on the video_format_cap array the driver builds at init.
	  One entry is needed per (pixel format, resolution) pair, not per pixel
	  format, since each entry carries its own width/height bounds.

	  A module reporting more pairs than this is truncated with a warning
	  rather than rejected: a partially usable camera beats a dead one.
```

## drivers/video/Kconfig.esp32_csi
```kconfig
# Copyright (c) 2026 Richard Osterloh
# SPDX-License-Identifier: Apache-2.0

config VIDEO_ESP32_CSI
	bool "ESP32 MIPI CSI-2 camera receiver"
	default y
	depends on DT_HAS_ESPRESSIF_ESP_MIPI_CSI_ENABLED
	depends on SOC_SERIES_ESP32P4
	select CACHE_MANAGEMENT if CPU_HAS_DCACHE
	help
	  Enable the ESP32-P4 MIPI CSI-2 receiver video capture driver. It drives
	  the CSI D-PHY, host and bridge, and a DW-GDMA channel that streams
	  frames from a downstream CSI-2 image sensor into memory.

	  RAW8, RAW10 and RAW12 (Bayer or greyscale) are captured as they arrive
	  on the link. The ISP is only used as a passthrough, so frames are not
	  demosaiced.
```

## drivers/video/Kconfig.esp32_i2s_cam
```kconfig
# Copyright (c) 2026 Richard Osterloh <richard.osterloh@gmail.com>
# SPDX-License-Identifier: Apache-2.0

config VIDEO_ESP32_I2S_CAM
	bool "ESP32 I2S camera-mode DVP receiver"
	default y
	depends on DT_HAS_ESPRESSIF_ESP32_I2S_CAM_ENABLED
	depends on SOC_SERIES_ESP32
	select PINCTRL
	select PWM
	select GPIO
	help
	  Capture JPEG frames from an 8-bit DVP sensor (e.g. OV2640) through the
	  original ESP32's I2S0 camera mode. DMA lands in an internal-RAM ring
	  that a driver thread copies into the application's video buffers, so
	  those buffers may live in PSRAM.

if VIDEO_ESP32_I2S_CAM

config VIDEO_ESP32_I2S_CAM_DMA_RING_SIZE
	int "DMA ring size in bytes"
	default 32768
	help
	  Internal-RAM DMA ring. Each JPEG byte occupies four bytes in the
	  ring, which is split into 4 KiB halves; the copy thread must drain a
	  half before the DMA laps it. Must be a multiple of 4096.

config VIDEO_ESP32_I2S_CAM_THREAD_PRIORITY
	int "Copy thread priority"
	default 2

config VIDEO_ESP32_I2S_CAM_THREAD_STACK_SIZE
	int "Copy thread stack size"
	default 1024

config VIDEO_ESP32_I2S_CAM_XCLK_INIT_PRIORITY
	int "XCLK start priority"
	default 55
	help
	  POST_KERNEL priority at which the sensor master clock starts. It
	  must come after PWM and before VIDEO_INIT_PRIORITY, because the
	  sensor needs XCLK to answer on SCCB during its own init.

endif
```

## dts/bindings/actuator/rosterloh,actuator-bus-servo.yaml
```yaml
description: Waveshare/SCServo bus-servo actuator

compatible: "rosterloh,actuator-bus-servo"

include: [actuator-common.yaml]

properties:
  reg:
    type: int
    required: true
    description: Servo bus ID.

  ticks-per-rev:
    type: int
    default: 4096

  rad-zero-tick:
    type: int
    default: 2047

  position-min-rad-milli:
    type: int
    description: |
      Lower travel limit in milliradians. OMITTING THIS MEANS UNLIMITED TRAVEL,
      not a safe default: the driver substitutes INT32_MIN, which rad_to_ticks()
      reads as the "no limit" sentinel and skips the clamp entirely. A node that
      forgets it drives the servo into its mechanical stop with no build error
      and no runtime error -- only the LOG_WRN that bus_servo_actuator_init()
      emits when either limit is absent.

      This is deliberately not `required: true`. A board devicetree may legally
      create the servo node for a connector it carries while knowing nothing
      about what is plugged into it, leaving the measured geometry to the
      application overlay; requiring the property here would make every such
      board unbuildable by any application that does not describe a head.

      Set it from a measurement, not a datasheet. rad_to_ticks() clamps to this
      range SILENTLY, so a too-narrow value is invisible from the host and
      presents as missing travel.

  position-max-rad-milli:
    type: int
    description: |
      Upper travel limit in milliradians. Absent means unlimited; see
      position-min-rad-milli for why that is a trap and why neither limit is
      required.

  invert-position:
    type: boolean
    description: |
      Flip the sign of the joint's positive sense relative to the servo's.

      This is a property of how the joint is assembled, not of the controller,
      so it belongs wherever the rest of the measured geometry lives. Note that
      a devicetree boolean cannot be un-set by a later fragment -- an overlay
      that needs it off must use `/delete-property/ invert-position;` -- which
      is the main reason a board devicetree should not assert it on behalf of
      an application.

  speed:
    type: int
    default: 300
    description: Position move speed passed to bus_servo_write_position_ex.

  accel:
    type: int
    default: 20
    description: Position move acceleration passed to bus_servo_write_position_ex.

  stall-torque-milli-nm:
    type: int
    default: 0
    description: |
      Stall torque in milli-newton-metres, used to convert the servo's
      present-load register (per-mille of stall torque) into the newton-metres
      the actuator effort feedback is defined in. 0, the default, leaves effort
      unreported rather than publishing a percentage as a torque.

      This is supply-dependent, not a part number: an ST3215 is quoted at
      30 kg*cm (2942) at 12 V but roughly 19 kg*cm (1863) at 7.4 V. Measure or
      derate it for the rail the servo actually runs on.
```

## dts/bindings/actuator/rosterloh,actuator-fake.yaml
```yaml
description: Fake actuator for tests.

compatible: "rosterloh,actuator-fake"

include: [actuator-common.yaml]

properties:
  capabilities:
    type: int
    default: 135  # POSITION | VELOCITY | EFFORT | DUTY
```
