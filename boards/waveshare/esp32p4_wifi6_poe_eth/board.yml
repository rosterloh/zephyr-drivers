## dts/bindings/actuator/rosterloh,actuator-hbridge.yaml
```yaml
description: |
  H-bridge DC motor with optional encoder and current sense.

  Open loop: the backend advertises ACTUATOR_CAP_DUTY only, and
  actuator_set_duty() sets the signed PWM duty (-1.0..1.0). The encoder
  and current sense populate feedback; nothing closes a loop on them.

  Signalling is selected by the presence of in2-gpios:
    - Only in1-gpios present  → PWM + DIR signalling (one direction GPIO).
      The driver does not advertise ACTUATOR_CAP_DRIVE_MODE in this mode.
    - in1-gpios and in2-gpios → PWM + IN1/IN2 signalling (TB6612FNG-class).
      The driver advertises ACTUATOR_CAP_DRIVE_MODE: BRAKE drives both
      inputs high (short brake), COAST drives both low (high-Z).

  stby-gpios is optional in either signalling. When wired, the driver
  asserts it on enable() and deasserts it on disable(). Use the
  GPIO_ACTIVE_LOW dt flag if the silicon's standby pin is active-low
  (e.g. TB6612 STBY).

compatible: "rosterloh,actuator-hbridge"

include: [actuator-common.yaml]

properties:
  pwms:
    type: phandle-array
    required: true
    description: PWM channel driving the H-bridge enable/PWM input.

  in1-gpios:
    type: phandle-array
    required: true
    description: |
      Bridge input 1. With in2-gpios present, this is the TB6612-style IN1.
      With in2-gpios absent, this is the single DIR pin.

  in2-gpios:
    type: phandle-array
    description: |
      Bridge input 2 (TB6612-style IN2). When present, the driver uses
      PWM + IN1/IN2 signalling and advertises ACTUATOR_CAP_DRIVE_MODE.

  stby-gpios:
    type: phandle-array
    description: |
      Optional standby/enable line. Asserted on actuator_enable, deasserted
      on actuator_disable. May be shared across instances by the application.

  io-channels:
    type: phandle-array
    description: |
      Optional ADC channel for current sense. Enables effort feedback (with
      torque-constant-mnm-per-a) and ACTUATOR_FAULT_OVERCURRENT detection.

  encoder:
    type: phandle
    description: |
      Optional phandle to a qdec sensor node. Enables position and velocity
      feedback.

  torque-constant-mnm-per-a:
    type: int
  max-current-ma:
    type: int

  current-sense-mohms:
    type: int
    description: |
      Shunt resistor value in milliohms used by the ADC current-sense path.
      Required when io-channels is set and CONFIG_ACTUATOR_HBRIDGE_CURRENT_SENSE
      is enabled. For an INA-style amplifier, set this to (R_shunt_mohms /
      amp_gain).

  pwm-period-ns:
    type: int
    default: 50000  # 20 kHz

  ramp-up-permille-per-s:
    type: int
    description: |
      Slew limit while the duty magnitude grows, in per-mille of full scale
      per second (2000 = 0 to full in 0.5 s). Unset or 0 = no limit.

  ramp-down-permille-per-s:
    type: int
    description: |
      Slew limit while the duty magnitude shrinks toward 0, including the
      first half of a reversal. Unset uses ramp-up-permille-per-s; 0 = no
      limit. A gentle value avoids reverse-current spikes when braking a
      loaded motor. actuator_disable() and BRAKE/COAST bypass the ramp.

  ramp-period-ms:
    type: int
    default: 10
    description: Tick of the ramp worker.
```

## dts/bindings/adc/adafruit,seesaw-adc.yaml
```yaml
description: |
  ADC child of an adafruit,seesaw-mfd MFD. The ATtiny variants of the
  seesaw firmware expose the chip's ADC on multiple pins (one channel per
  GPIO pin number). Channel IDs in adc-sequence map directly to those
  pin numbers (0..31). On the SAMD09 variant channels 0..3 are its four
  ADC inputs, on chip pins 2..5 respectively.

compatible: "adafruit,seesaw-adc"

include: [adc-controller.yaml, base.yaml]

properties:
  "#io-channel-cells":
    const: 1

io-channel-cells:
  - input
```

## dts/bindings/ethercat/microchip,lan9252.yaml
```yaml
# Copyright (c) 2026 Richard Osterloh
# SPDX-License-Identifier: Apache-2.0

description: Microchip LAN9252 EtherCAT SubDevice controller on SPI

compatible: "microchip,lan9252"

include: spi-device.yaml

properties:
  int-gpios:
    type: phandle-array
    description: |
      Optional LAN9252 IRQ pin. The pin polarity should describe the board
      wiring; the LAN9252 IRQ output is typically active low.

  reset-gpios:
    type: phandle-array
    description: |
      Optional LAN9252 reset pin. The pin polarity should describe the board
      wiring; the LAN9252 RST# input is active low.

  reset-assert-us:
    type: int
    default: 1000
    description: Reset assertion time in microseconds when reset-gpios is present.

  reset-deassert-us:
    type: int
    default: 1000
    description: Delay after reset deassertion before polling the SPI interface.

  init-timeout-ms:
    type: int
    default: 100
    description: Timeout for BYTE_TEST and READY polling during device init.
```

## dts/bindings/ethernet/adi,adin3310.yaml
```yaml
# Copyright (c) 2026 Richard Osterloh
# SPDX-License-Identifier: Apache-2.0

description: Analog Devices ADIN3310 Ethernet switch management interface on SPI

compatible: "adi,adin3310"

include: spi-device.yaml

properties:
  int-gpios:
    type: phandle-array
    description: |
      Optional ADIN3310 interrupt pin. The pin polarity should describe
      the board wiring.

  reset-gpios:
    type: phandle-array
    description: |
      Optional ADIN3310 reset pin. The pin polarity should describe the
      board wiring.

  reset-assert-us:
    type: int
    default: 1000
    description: Reset assertion time in microseconds when reset-gpios is present.

  reset-deassert-us:
    type: int
    default: 1000
    description: Delay after reset deassertion before using the SPI interface.

  port-count:
    type: int
    const: 3
    default: 3
    description: Number of external switch ports on the ADIN3310.
```

## dts/bindings/sensor/invensense,icm20948.yaml
```yaml
# Copyright (c) 2026 Richard Osterloh
# SPDX-License-Identifier: Apache-2.0

description: |
  TDK InvenSense ICM-20948 9-axis IMU, accelerometer and gyroscope only.

  The part also carries an AK09916 magnetometer behind its own I2C master.
  This driver does not expose it: reaching it needs either the aux-bus master
  or BYPASS_EN, and nothing needs it yet. Add a second compatible when
  something does.

compatible: "invensense,icm20948"

include: [sensor-device.yaml, i2c-device.yaml]

properties:
  accel-fs:
    type: int
    default: 2
    enum: [2, 4, 8, 16]
    description: |
      Accelerometer full-scale range in g. The default matches the part's
      power-on setting, and gives the finest resolution.

  gyro-fs:
    type: int
    default: 250
    enum: [250, 500, 1000, 2000]
    description: |
      Gyroscope full-scale range in degrees per second. The default matches the
      part's power-on setting. Raise it if the application saturates the range
      — a saturated axis reads a hard limit, not an error.
```

## dts/bindings/sensor/liteon,ltr308.yaml
```yaml
# Copyright (c) 2026 Richard Osterloh <richard.osterloh@gmail.com>
# SPDX-License-Identifier: Apache-2.0

description: Lite-On LTR-308ALS-01 ambient light sensor

compatible: "liteon,ltr308"

include: [sensor-device.yaml, i2c-device.yaml]

properties:
  gain:
    type: int
    default: 3
    enum: [1, 3, 6, 9, 18]
    description: Analog gain. The default is the power-on value.

  integration-time-ms:
    type: int
    default: 100
    enum: [400, 200, 100, 50, 25]
    description: |
      Conversion time; resolution is 20, 19, 18, 17 or 16 bits in that
      order. The default is the power-on value.

  measurement-rate-ms:
    type: int
    default: 100
    enum: [25, 50, 100, 500, 1000, 2000]
    description: |
      Time between conversions; not shorter than integration-time-ms.
      The default is the power-on value.
```

## dts/bindings/video/arducam,pivariety.yaml
```yaml
# Copyright (c) 2026 Richard Osterloh
# SPDX-License-Identifier: Apache-2.0

description: |
  Arducam Pivariety camera module.

  Pivariety modules are not bare sensors: an on-module MCU exposes a small
  self-describing register interface, so one driver serves the whole family.
  Formats, resolutions and controls are enumerated at runtime, which is why
  this binding carries no sensor-specific properties.

  The module reports no link frequency of its own, so link-frequencies on the
  endpoint is required -- the CSI-2 receiver needs it to configure its D-PHY.

compatible: "arducam,pivariety"

include: [i2c-device.yaml]

child-binding:
  child-binding:
    include: video-interfaces.yaml
```

## dts/bindings/video/espressif,esp-mipi-csi.yaml
```yaml
# Copyright (c) 2026 Richard Osterloh
# SPDX-License-Identifier: Apache-2.0

description: |
  Espressif ESP32 MIPI CSI-2 camera receiver.

  Drives the CSI-2 D-PHY, host and bridge, and a DW-GDMA channel that captures
  frames from a downstream CSI-2 image sensor into memory. The single video
  port describes the CSI-2 link to that sensor.

  Frame completion is signalled by the DW-GDMA channel that drains the bridge,
  so the interrupt is the DW-GDMA's, shared with any other DW-GDMA user such
  as the MIPI DSI display controller.

  Example:

      &mipi_csi {
          status = "okay";

          port {
              csi_ep_in: endpoint {
                  remote-endpoint-label = "imx219_ep_out";
                  bus-type = <VIDEO_BUS_TYPE_CSI2_DPHY>;
                  data-lanes = <1 2>;
              };
          };
      };

compatible: "espressif,esp-mipi-csi"

include: [base.yaml]

properties:
  reg:
    required: true

  reg-names:
    required: true
    description: Must list "host" and "bridge".

  interrupts:
    required: true

  dma-channel:
    type: int
    required: true
    min: 0
    max: 3
    description: |
      DW-GDMA channel that drains the CSI bridge into memory. It must not be
      the channel used by another DW-GDMA user, such as the dma-channel of an
      enabled espressif,esp-dsi-display node.

child-binding:
  description: The CSI-2 input port.
  child-binding:
    description: The endpoint connected to the image sensor.
    include: video-interfaces.yaml
    properties:
      bus-type:
        required: true

      data-lanes:
        required: true
        description: |
          CSI-2 data lanes in use. The ESP32-P4 D-PHY has two, so this is
          <1> or <1 2>.
```
