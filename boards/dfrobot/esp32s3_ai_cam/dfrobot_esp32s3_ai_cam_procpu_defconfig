## boards/dfrobot/esp32s3_ai_cam/dfrobot_esp32s3_ai_cam_procpu_defconfig
```kconfig
# Copyright (c) 2026 Richard Osterloh <richard.osterloh@gmail.com>
# SPDX-License-Identifier: Apache-2.0

CONFIG_CONSOLE=y
CONFIG_SERIAL=y
CONFIG_UART_CONSOLE=y
CONFIG_GPIO=y
CONFIG_CLOCK_CONTROL=y
CONFIG_SOC_FAMILY_ESPRESSIF_SPIRAM=y
CONFIG_SOC_FAMILY_ESPRESSIF_SPIRAM_MODE_OCT=y
CONFIG_SOC_FAMILY_ESPRESSIF_SPIRAM_SPEED_80M=y
CONFIG_SOC_FAMILY_ESPRESSIF_FLASH_MODE_QIO=y
```

## drivers/opentherm/Kconfig
```kconfig
config OPENTHERM
	bool "OpenTherm master"
	default y
	depends on DT_HAS_OPENTHERM_GPIO_ENABLED || DT_HAS_OPENTHERM_PULSE_IO_ENABLED
	help
	  OpenTherm master (thermostat side) talking to a boiler through an
	  external OpenTherm line adapter.

if OPENTHERM

config OPENTHERM_GPIO
	bool "OpenTherm on two GPIOs"
	default y
	depends on DT_HAS_OPENTHERM_GPIO_ENABLED
	depends on GPIO
	help
	  Clocks half-bits from a k_timer and decodes the reply from GPIO edge
	  interrupts. CONFIG_SYS_CLOCK_TICKS_PER_SEC must be a multiple of
	  2000 (Espressif SoCs default to 1000; use 10000). The GPIOs must be
	  settable from an ISR (SoC GPIO, not an expander).

config OPENTHERM_PULSE_IO
	bool "OpenTherm on pulse_io channels"
	default y
	depends on DT_HAS_OPENTHERM_PULSE_IO_ENABLED
	depends on PULSE_IO
	help
	  Lets pulse_io hardware (e.g. the ESP32 RMT) time the request and
	  capture the reply.

config OPENTHERM_INIT_PRIORITY
	int "OpenTherm init priority"
	default 85
	help
	  Must be after the GPIO and pulse_io controllers.

module = OPENTHERM
module-str = opentherm
source "subsys/logging/Kconfig.template.log_config"

endif # OPENTHERM
```

## dts/bindings/opentherm/opentherm-gpio.yaml
```yaml
description: |
  OpenTherm master (thermostat side) on two GPIOs through an external line
  adapter, which converts between logic levels and the OpenTherm bus.

  Logical level 1 on either pin means the line state during the first half of
  a '1' bit; the line is idle at logical 0. Use the GPIO flags to match the
  adapter. For Ihor Melnyk's adapter (inverting output stage) that is,
  untested on hardware:

    opentherm {
        compatible = "opentherm-gpio";
        out-gpios = <&gpio0 4 GPIO_ACTIVE_LOW>;
        in-gpios = <&gpio0 5 GPIO_ACTIVE_HIGH>;
    };

compatible: "opentherm-gpio"

properties:
  out-gpios:
    type: phandle-array
    required: true
    description: Output to the adapter's transmit input.

  in-gpios:
    type: phandle-array
    required: true
    description: |
      Input from the adapter's receive output. Needs an interrupt on both
      edges.
```

## dts/bindings/opentherm/opentherm-pulse-io.yaml
```yaml
description: |
  OpenTherm master (thermostat side) on a pulse_io controller, such as the
  ESP32 RMT, through an external line adapter. The controller times the
  request and captures the reply, so the CPU only sees one interrupt per
  frame instead of one per edge.

  Logical level 1 is the line state during the first half of a '1' bit; the
  line idles at logical 0. If the adapter idles a pin high, set the matching
  *-idle-high property. For Ihor Melnyk's adapter (inverting output stage)
  that is, untested on hardware:

    opentherm {
        compatible = "opentherm-pulse-io";
        pulse-ios = <&rmt 0>, <&rmt 2>;
        tx-idle-high;
    };

  The pins are routed by the controller's pinctrl state.

compatible: "opentherm-pulse-io"

properties:
  pulse-ios:
    type: phandle-array
    required: true
    description: |
      Transmit channel, then receive channel, on the same controller. They
      may be the same channel only on backends that allow both directions
      on one channel (the software loopback).

  tx-idle-high:
    type: boolean
    description: The transmit pin idles high.

  rx-idle-high:
    type: boolean
    description: The receive pin idles high.
```

## tests/drivers/opentherm/testcase.yaml
```yaml
tests:
  drivers.opentherm:
    tags:
      - drivers
      - opentherm
    harness: ztest
    platform_allow:
      - native_sim
    integration_platforms:
      - native_sim
```
