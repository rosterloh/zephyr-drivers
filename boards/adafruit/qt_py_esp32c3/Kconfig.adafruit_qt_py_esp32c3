## boards/aithinker/ai_thinker_esp32_cam/Kconfig
```kconfig
# Copyright (c) 2026 Richard Osterloh <richard.osterloh@gmail.com>
# SPDX-License-Identifier: Apache-2.0

config HEAP_MEM_POOL_ADD_SIZE_BOARD
	int
	default 4096 if BOARD_AI_THINKER_ESP32_CAM_ESP32_PROCPU
```

## boards/aithinker/ai_thinker_esp32_cam/Kconfig.ai_thinker_esp32_cam
```kconfig
# Copyright (c) 2026 Richard Osterloh <richard.osterloh@gmail.com>
# SPDX-License-Identifier: Apache-2.0

config BOARD_AI_THINKER_ESP32_CAM
	select SOC_ESP32
	select SOC_ESP32_PROCPU if BOARD_AI_THINKER_ESP32_CAM_ESP32_PROCPU
```

## boards/aithinker/ai_thinker_esp32_cam/ai_thinker_esp32_cam_procpu_defconfig
```kconfig
# Copyright (c) 2026 Richard Osterloh <richard.osterloh@gmail.com>
# SPDX-License-Identifier: Apache-2.0

CONFIG_CONSOLE=y
CONFIG_SERIAL=y
CONFIG_UART_CONSOLE=y
CONFIG_GPIO=y
CONFIG_CLOCK_CONTROL=y
```

## boards/aithinker/ai_thinker_esp32_cam/board.yml
```yaml
board:
  name: ai_thinker_esp32_cam
  full_name: AI-Thinker ESP32-CAM
  vendor: aithinker
  socs:
    - name: esp32
```

## boards/dfrobot/esp32s3_ai_cam/Kconfig
```kconfig
# Copyright (c) 2026 Richard Osterloh <richard.osterloh@gmail.com>
# SPDX-License-Identifier: Apache-2.0

config HEAP_MEM_POOL_ADD_SIZE_BOARD
	int
	default 4096 if BOARD_DFROBOT_ESP32S3_AI_CAM_ESP32S3_PROCPU || \
		BOARD_DFROBOT_ESP32S3_AI_CAM_ESP32S3_PROCPU_QEMU
	default 256 if BOARD_DFROBOT_ESP32S3_AI_CAM_ESP32S3_APPCPU
```

## boards/dfrobot/esp32s3_ai_cam/Kconfig.dfrobot_esp32s3_ai_cam
```kconfig
# Copyright (c) 2026 Richard Osterloh <richard.osterloh@gmail.com>
# SPDX-License-Identifier: Apache-2.0

config BOARD_DFROBOT_ESP32S3_AI_CAM
	select SOC_ESP32S3
	select SOC_ESP32S3_PROCPU if BOARD_DFROBOT_ESP32S3_AI_CAM_ESP32S3_PROCPU || \
		BOARD_DFROBOT_ESP32S3_AI_CAM_ESP32S3_PROCPU_QEMU
	select SOC_ESP32S3_APPCPU if BOARD_DFROBOT_ESP32S3_AI_CAM_ESP32S3_APPCPU
```

## boards/dfrobot/esp32s3_ai_cam/board.yml
```yaml
board:
  name: dfrobot_esp32s3_ai_cam
  full_name: DFRobot ESP32-S3 AI Camera (DFR1154)
  vendor: dfrobot
  socs:
    - name: esp32s3
      variants:
        - name: qemu
          cpucluster: procpu
```

## boards/dfrobot/esp32s3_ai_cam/dfrobot_esp32s3_ai_cam_appcpu_defconfig
```kconfig
# Copyright (c) 2026 Richard Osterloh <richard.osterloh@gmail.com>
# SPDX-License-Identifier: Apache-2.0

CONFIG_CLOCK_CONTROL=y
```

## boards/dfrobot/esp32s3_ai_cam/dfrobot_esp32s3_ai_cam_procpu_defconfig
```kconfig
# Copyright (c) 2026 Richard Osterloh <richard.osterloh@gmail.com>
# SPDX-License-Identifier: Apache-2.0

CONFIG_CONSOLE=y
CONFIG_SERIAL=y
CONFIG_UART_CONSOLE=y
CONFIG_GPIO=y
CONFIG_CLOCK_CONTROL=y
CONFIG_ESP_SPIRAM=y
CONFIG_SPIRAM_MODE_OCT=y
```

## boards/m5stack/unit_poe_p4/Kconfig
```kconfig
# Copyright (c) 2026 Richard Osterloh

config HEAP_MEM_POOL_ADD_SIZE_BOARD
	int
	default 4096 if BOARD_M5STACK_UNIT_POE_P4_ESP32P4_HPCORE
	default 256 if BOARD_M5STACK_UNIT_POE_P4_ESP32P4_LPCORE
```

## boards/m5stack/unit_poe_p4/board.yml
```yaml
board:
  name: m5stack_unit_poe_p4
  full_name: M5Stack Unit PoE-P4
  vendor: m5stack
  socs:
  - name: esp32p4
```

## boards/m5stack/unit_poe_p4/m5stack_unit_poe_p4_esp32p4_lpcore_defconfig
```kconfig
# SPDX-License-Identifier: Apache-2.0

CONFIG_THREAD_STACK_INFO=n
CONFIG_THREAD_CUSTOM_DATA=n
CONFIG_BOOT_BANNER=n
CONFIG_SERIAL=n
CONFIG_CONSOLE=n
CONFIG_PRINTK=n
CONFIG_CBPRINTF_NANO=y
CONFIG_SIZE_OPTIMIZATIONS=y
CONFIG_BUSYWAIT_CPU_LOOPS_PER_USEC=4
```

## boards/shields/arducam_tof_camera/Kconfig.shield
```kconfig
# Copyright (c) 2026 Richard Osterloh <richard.osterloh@gmail.com>
# SPDX-License-Identifier: Apache-2.0

config SHIELD_ARDUCAM_TOF_CAMERA
	def_bool $(shields_list_contains,arducam_tof_camera)
```

## boards/waveshare/esp32_s3_eth/Kconfig.waveshare_esp32_s3_eth
```kconfig
# Copyright (c) 2026 Richard Osterloh <richard.osterloh@gmail.com>
# SPDX-License-Identifier: Apache-2.0

config BOARD_WAVESHARE_ESP32_S3_ETH
	select SOC_ESP32S3
	select SOC_ESP32S3_PROCPU if BOARD_WAVESHARE_ESP32_S3_ETH_ESP32S3_PROCPU || \
		BOARD_WAVESHARE_ESP32_S3_ETH_ESP32S3_PROCPU_QEMU
	select SOC_ESP32S3_APPCPU if BOARD_WAVESHARE_ESP32_S3_ETH_ESP32S3_APPCPU
```
