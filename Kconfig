## Kconfig
```kconfig
rsource "drivers/Kconfig"
rsource "subsys/actuator/Kconfig"
rsource "subsys/net/wifi_connectivity/Kconfig"
rsource "lib/actuator/Kconfig"
rsource "lib/kinematics/Kconfig"
rsource "lib/cdr/Kconfig"
```

## boards/adafruit/qt_py_esp32c3/board.yml
```yaml
board:
  name: adafruit_qt_py_esp32c3
  full_name: QT Py ESP32-C3
  vendor: adafruit
  socs:
  - name: esp32c3
```

## boards/shields/adafruit_neokey_1x4/Kconfig.shield
```kconfig
# Copyright (c) 2026 Richard Osterloh <richard.osterloh@gmail.com>
# SPDX-License-Identifier: Apache-2.0

config SHIELD_ADAFRUIT_NEOKEY_1X4
	def_bool $(shields_list_contains,adafruit_neokey_1x4)
```

## boards/shields/adafruit_neoslider/Kconfig.shield
```kconfig
# Copyright (c) 2026 Richard Osterloh <richard.osterloh@gmail.com>
# SPDX-License-Identifier: Apache-2.0

config SHIELD_ADAFRUIT_NEOSLIDER
	def_bool $(shields_list_contains,adafruit_neoslider)
```

## boards/shields/adafruit_rotary_encoder/Kconfig.shield
```kconfig
# Copyright (c) 2026 Richard Osterloh <richard.osterloh@gmail.com>
# SPDX-License-Identifier: Apache-2.0

config SHIELD_ADAFRUIT_ROTARY_ENCODER
	def_bool $(shields_list_contains,adafruit_rotary_encoder)
```

## boards/waveshare/esp32_s3_eth/Kconfig
```kconfig
# Copyright (c) 2026 Richard Osterloh <richard.osterloh@gmail.com>
# SPDX-License-Identifier: Apache-2.0

config HEAP_MEM_POOL_ADD_SIZE_BOARD
	int
	default 4096 if BOARD_WAVESHARE_ESP32_S3_ETH_ESP32S3_PROCPU
	default 256 if BOARD_WAVESHARE_ESP32_S3_ETH_ESP32S3_APPCPU
```

## boards/waveshare/esp32_s3_eth/Kconfig.sysbuild
```kconfig
# Copyright (c) 2026 Richard Osterloh <richard.osterloh@gmail.com>
# SPDX-License-Identifier: Apache-2.0

choice BOOTLOADER
	default BOOTLOADER_MCUBOOT
endchoice

choice BOOT_SIGNATURE_TYPE
	default BOOT_SIGNATURE_TYPE_NONE
endchoice
```

## boards/waveshare/esp32_s3_eth/board.yml
```yaml
board:
  name: waveshare_esp32_s3_eth
  full_name: ESP32-S3-ETH
  vendor: waveshare
  socs:
    - name: esp32s3
```

## boards/waveshare/esp32p4_nano/Kconfig
```kconfig
# Copyright (c) 2026 Richard Osterloh
# SPDX-License-Identifier: Apache-2.0

config HEAP_MEM_POOL_ADD_SIZE_BOARD
	int
	default 4096 if BOARD_ESP32P4_NANO_ESP32P4_HPCORE
	default 256 if BOARD_ESP32P4_NANO_ESP32P4_LPCORE
```

## boards/waveshare/esp32p4_nano/Kconfig.defconfig
```kconfig
# Copyright (c) 2026 Richard Osterloh
# SPDX-License-Identifier: Apache-2.0

if BOARD_ESP32P4_NANO_ESP32P4_HPCORE

configdefault NET_L2_ETHERNET
	default y

endif # BOARD_ESP32P4_NANO_ESP32P4_HPCORE
```

## boards/waveshare/esp32p4_nano/Kconfig.esp32p4_nano
```kconfig
# Copyright (c) 2026 Richard Osterloh
# SPDX-License-Identifier: Apache-2.0

config BOARD_ESP32P4_NANO
	select SOC_ESP32P4_HPCORE if BOARD_ESP32P4_NANO_ESP32P4_HPCORE
	select SOC_ESP32P4_LPCORE if BOARD_ESP32P4_NANO_ESP32P4_LPCORE
```

## boards/waveshare/esp32p4_nano/board.yml
```yaml
# Copyright (c) 2026 Richard Osterloh
# SPDX-License-Identifier: Apache-2.0

board:
  name: esp32p4_nano
  full_name: ESP32-P4-Nano
  vendor: waveshare
  socs:
  - name: esp32p4
```

## boards/waveshare/esp32p4_wifi6_poe_eth/esp32p4_wifi6_poe_eth_hpcore_defconfig
```kconfig
# Copyright (c) 2026 Richard Osterloh
# SPDX-License-Identifier: Apache-2.0

CONFIG_CONSOLE=y
CONFIG_SERIAL=y
CONFIG_UART_CONSOLE=y
CONFIG_GPIO=y
CONFIG_REGULATOR=y
```

## boards/waveshare/ros_driver/Kconfig
```kconfig
# ROS Driver for Robots board configuration

config HEAP_MEM_POOL_ADD_SIZE_BOARD
	int
	default 4096 if BOARD_ROS_DRIVER_ESP32_PROCPU
	default 256 if BOARD_ROS_DRIVER_ESP32_APPCPU
```

## boards/waveshare/ros_driver/Kconfig.ros_driver
```kconfig
# ROS Driver for Robots board configuration

config BOARD_ROS_DRIVER
	select SOC_ESP32_WROOM_32UE_N4
	select SOC_ESP32_PROCPU if BOARD_ROS_DRIVER_ESP32_PROCPU
	select SOC_ESP32_APPCPU if BOARD_ROS_DRIVER_ESP32_APPCPU
	# The board's partition table reserves slot0 at 0x10000; mark this so
	# Zephyr's USE_DT_CODE_PARTITION can satisfy its dependency when sysbuild
	# enables BOOTLOADER_MCUBOOT.
	select HAS_FLASH_LOAD_OFFSET
```

## boards/waveshare/ros_driver/board.yml
```yaml
board:
    name: ros_driver
    full_name: Waveshare ROS Driver Board
    vendor: waveshare
    socs:
    - name: esp32
```

## drivers/actuator/bus_servo/Kconfig
```kconfig
config ACTUATOR_BUS_SERVO
	bool "Waveshare bus-servo actuator backend"
	depends on ACTUATOR && BUS_SERVO
	depends on DT_HAS_ROSTERLOH_ACTUATOR_BUS_SERVO_ENABLED
	default n
	help
	  Wraps the Waveshare/SCServo bus-servo protocol driver and exposes
	  each servo on the bus as a generic actuator device.
```

## drivers/actuator/dxl/Kconfig
```kconfig
config ACTUATOR_DXL
	bool "Dynamixel actuator backend"
	depends on ACTUATOR && DYNAMIXEL
	default n
	help
	  Wraps the rosterloh dynamixel protocol driver and exposes each motor
	  on the bus as an actuator device.
```

## drivers/actuator/fake/Kconfig
```kconfig
config ACTUATOR_FAKE
	bool "Fake actuator driver (for tests)"
	depends on ACTUATOR
	default n
```

## drivers/actuator/hbridge/Kconfig
```kconfig
config ACTUATOR_HBRIDGE
	bool "H-bridge actuator backend"
	depends on ACTUATOR && PWM && GPIO
	default n

config ACTUATOR_HBRIDGE_CURRENT_SENSE
	bool "Enable ADC-based current sense"
	depends on ACTUATOR_HBRIDGE && ADC

config ACTUATOR_HBRIDGE_ENCODER
	bool "Enable qdec-based position/velocity feedback"
	depends on ACTUATOR_HBRIDGE && SENSOR
```

## drivers/adc/Kconfig.adafruit_seesaw
```kconfig
config ADC_ADAFRUIT_SEESAW
	bool "Adafruit Seesaw ADC"
	default y
	depends on DT_HAS_ADAFRUIT_SEESAW_ADC_ENABLED
	depends on MFD_ADAFRUIT_SEESAW
	depends on ADC
	select ADC_CONFIGURABLE_INPUTS
	help
	  Adafruit Seesaw ADC child driver.

if ADC_ADAFRUIT_SEESAW
module = ADC_ADAFRUIT_SEESAW
module-str = adc_adafruit_seesaw
source "subsys/logging/Kconfig.template.log_config"

config ADC_ADAFRUIT_SEESAW_INIT_PRIORITY
	int "Init priority"
	default 85
	help
	  Must be greater than MFD_ADAFRUIT_SEESAW_INIT_PRIORITY (80).

config ADC_ADAFRUIT_SEESAW_ACQUISITION_THREAD_PRIO
	int "Acquisition thread priority"
	default 0
	help
	  Priority for the cooperative thread that performs ADC reads on
	  behalf of adc_read().
endif
```

## drivers/bus_servo/Kconfig
```kconfig
config BUS_SERVO
	bool "Waveshare bus servo"
	depends on SERIAL && SERIAL_HAS_DRIVER
	depends on DT_HAS_WAVESHARE_BUS_SERVO_ENABLED
	select UART_USE_RUNTIME_CONFIGURE
	help
	  Enable the Waveshare/SCServo-style serial bus-servo protocol core.

if BUS_SERVO

module = BUS_SERVO
module-str = bus_servo
source "subsys/logging/Kconfig.template.log_config"

endif # BUS_SERVO
```

## drivers/dynamixel/Kconfig
```kconfig
menuconfig DYNAMIXEL
	bool "Robotis Dynamixel Servo"
	default y
	depends on SERIAL && SERIAL_HAS_DRIVER
	depends on DT_HAS_ROBOTIS_DYNAMIXEL_ENABLED
	select UART_USE_RUNTIME_CONFIGURE
	select CRC
	help
	  Enable driver for Robotis Dynamixel Servo motors.

if DYNAMIXEL

config DYNAMIXEL_BUFFER_SIZE
	int "Dynamixel buffer size"
	default 256
	range 64 1024
	help
	  Maximum frame size (bytes) for the Dynamixel TX/RX buffers.
	  Must be large enough for the largest packet you intend to send.

	  SYNC_WRITE  ~= 14 + N * (1 + L)
	  BULK_WRITE  ~= 10 + N * (5 + L)

	  where N is the number of servos addressed and L is the register
	  width in bytes. The default of 256 covers ~12 servos x 4-byte
	  writes; raise it if you need more.

module = DYNAMIXEL
module-str = dynamixel
source "subsys/logging/Kconfig.template.log_config"

endif # DYNAMIXEL
```
