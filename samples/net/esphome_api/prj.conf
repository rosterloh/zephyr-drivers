## CMakeLists.txt
```
# SPDX-License-Identifier: Apache-2.0

cmake_minimum_required(VERSION 3.20.0)
find_package(Zephyr REQUIRED HINTS $ENV{ZEPHYR_BASE})
project(esphome_api_sample)

target_sources(app PRIVATE src/main.c)
```

## sample.yaml
```
sample:
  name: ESPHome native API server
common:
  tags: [esphome_api, sample]
  modules: [nanopb]
tests:
  sample.net.esphome_api:
    platform_allow: [native_sim]
    integration_platforms: [native_sim]
    harness: pytest
    harness_config:
      pytest_root: ["pytest/test_esphome_api.py"]
  sample.net.esphome_api.noise:
    platform_allow: [native_sim]
    integration_platforms: [native_sim]
    modules: [nanopb, mbedtls, tf-psa-crypto]
    # Its own port: twister runs both scenarios at once on the host's sockets.
    extra_args: EXTRA_CONF_FILE=noise.conf
    extra_configs:
      - CONFIG_ESPHOME_API_PORT=6054
    harness: pytest
    harness_config:
      pytest_root: ["pytest/test_esphome_api.py"]
  sample.net.esphome_api.build:
    build_only: true
    platform_allow: [qemu_cortex_m3, esp32c3_devkitc/esp32c3/qemu]
    integration_platforms: [qemu_cortex_m3]
    extra_args: EXTRA_CONF_FILE=noise.conf
    modules: [nanopb, mbedtls, tf-psa-crypto]
```

## prj.conf
```kconfig
CONFIG_NETWORKING=y
CONFIG_NET_SOCKETS=y
CONFIG_NET_TCP=y
CONFIG_NET_IPV4=y
CONFIG_NET_IPV6=n
CONFIG_NET_DHCPV4=y
CONFIG_NET_CONFIG_SETTINGS=y

# <hostname>.local is the device name Home Assistant shows.
CONFIG_NET_HOSTNAME_ENABLE=y
CONFIG_NET_HOSTNAME="zephyr-esphome"
CONFIG_MDNS_RESPONDER=y
CONFIG_DNS_SD=y

CONFIG_ESPHOME_API=y
CONFIG_ESPHOME_API_FRIENDLY_NAME="Zephyr ESPHome sample"

CONFIG_LOG=y
```

## noise.conf
```kconfig
CONFIG_ESPHOME_API_NOISE=y
# Development key only: base64 of bytes 00..1f. Provision real keys with esphome_api_set_psk().
CONFIG_ESPHOME_API_NOISE_PSK="AAECAwQFBgcICQoLDA0ODxAREhMUFRYXGBkaGxwdHh8="
```

## boards/native_sim.conf
```kconfig
# Host sockets, so a client on the host reaches 127.0.0.1:<port>. No multicast, so no mDNS.
CONFIG_NET_DRIVERS=y
CONFIG_NET_NATIVE_OFFLOADED_SOCKETS=y
CONFIG_NET_SOCKETS_OFFLOAD=y
CONFIG_ETH_NATIVE_TAP=n
CONFIG_NET_DHCPV4=n
CONFIG_NET_CONFIG_SETTINGS=n
CONFIG_MDNS_RESPONDER=n
CONFIG_ZVFS_OPEN_MAX=16
```

## src/main.c
```c
/*
 * One sensor, switch and button exposed to Home Assistant.
 *
 * SPDX-License-Identifier: Apache-2.0
 */

#include <zephyr/kernel.h>
#include <zephyr/logging/log.h>
#include <zephyr/net/esphome_api.h>

LOG_MODULE_REGISTER(sample, LOG_LEVEL_INF);

static void relay_set(struct esphome_entity *e, bool state)
{
	LOG_INF("relay %s", state ? "on" : "off");
	/* Home Assistant shows the state the device reports, so confirm it. */
	esphome_api_publish_bool(e, state);
}

static void reset_press(struct esphome_entity *e)
{
	LOG_INF("reset pressed");
}

ESPHOME_SENSOR_DEFINE(temperature, .name = "Temperature", .unit = "°C",
		      .device_class = "temperature", .state_class = ESPHOME_STATE_CLASS_MEASUREMENT,
		      .accuracy_decimals = 1);
ESPHOME_SWITCH_DEFINE(relay, .name = "Relay", .icon = "mdi:electric-switch",
		      .on_switch = relay_set);
ESPHOME_BUTTON_DEFINE(reset, .name = "Reset", .device_class = "restart", .on_press = reset_press);

int main(void)
{
	float t = 20.0f;

	(void)esphome_api_publish_bool(&relay, false);
	while (true) {
		/* A stand-in reading that ramps 20.0 .. 24.5 °C. */
		(void)esphome_api_publish_float(&temperature, t);
		t = t >= 24.5f ? 20.0f : t + 0.5f;
		k_sleep(K_SECONDS(1));
	}

	return 0;
}
```
