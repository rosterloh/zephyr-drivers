## CMakeLists.txt
```
cmake_minimum_required(VERSION 3.20.0)
find_package(Zephyr REQUIRED HINTS $ENV{ZEPHYR_BASE})
project(kinematics_sample)
target_sources(app PRIVATE src/main.c)
```

## sample.yaml
```
sample:
  name: Kinematics joint descriptors
common:
  tags: [kinematics, sample]
  harness: console
  harness_config:
    type: one_line
    regex:
      - "kinematics: 2 joint\\(s\\)"
tests:
  sample.kinematics:
    platform_allow: [native_sim]
```

## prj.conf
```kconfig
CONFIG_KINEMATICS=y
CONFIG_CBPRINTF_FP_SUPPORT=y
```

## app.overlay
```dts
/ {
	joint_base: joint-base {
		compatible = "rosterloh,joint";
		link-parent = "world";
		link-child = "base_link";
		joint-type = "fixed";
		axis = <0 0 1000>;
		origin-xyz = <0 0 0>;
		origin-rpy = <0 0 0>;
	};

	joint_shoulder: joint-shoulder {
		compatible = "rosterloh,joint";
		link-parent = "base_link";
		link-child = "upper_arm";
		joint-type = "revolute";
		axis = <0 0 1000>;
		origin-xyz = <0 0 100000>;       /* 0.1 m */
		origin-rpy = <0 0 0>;
		limit-lower = <(-1570796)>;
		limit-upper = <1570796>;
		limit-velocity = <3141592>;
		limit-effort = <2500>;
	};
};
```

## src/main.c
```c
/*
 * Copyright (c) 2026 Richard Osterloh <richard.osterloh@gmail.com>
 * SPDX-License-Identifier: Apache-2.0
 */

#include <stdint.h>
#include <zephyr/kernel.h>
#include <zephyr/sys/printk.h>
#include <zephyr/kinematics/joint.h>

static const char *type_str(enum joint_type t)
{
	switch (t) {
	case JOINT_TYPE_FIXED:
		return "fixed";
	case JOINT_TYPE_REVOLUTE:
		return "revolute";
	case JOINT_TYPE_CONTINUOUS:
		return "continuous";
	case JOINT_TYPE_PRISMATIC:
		return "prismatic";
	default:
		return "?";
	}
}

int main(void)
{
	const size_t n = kinematics_joint_count();

	printk("kinematics: %zu joint(s)\n", n);
	for (size_t i = 0; i < n; i++) {
		const struct joint_descriptor *j = kinematics_joint_get(i);

		printk("  [%zu] %s -> %s (%s) origin=(%.3f %.3f %.3f) actuated=%d\n", i,
		       j->parent_link, j->child_link, type_str(j->type), (double)j->origin_xyz[0],
		       (double)j->origin_xyz[1], (double)j->origin_xyz[2],
		       (j->valid_mask & JOINT_HAS_ACTUATOR) ? 1 : 0);
	}

	uint8_t buf[512];
	size_t out_len = 0;
	int rc = kinematics_encode_cbor(buf, sizeof(buf), &out_len);

	if (rc != 0) {
		printk("encode failed: %d\n", rc);
		return 0;
	}

	printk("CBOR (%zu bytes):", out_len);
	for (size_t i = 0; i < out_len; i++) {
		printk(" %02x", buf[i]);
	}
	printk("\n");
	return 0;
}
```
