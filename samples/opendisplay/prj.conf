## CMakeLists.txt
```
# SPDX-License-Identifier: Apache-2.0

cmake_minimum_required(VERSION 3.20.0)
find_package(Zephyr REQUIRED HINTS $ENV{ZEPHYR_BASE})
project(opendisplay)
target_sources(app PRIVATE src/main.c)
```

## sample.yaml
```
sample:
  name: OpenDisplay receiver
  description: Receive images from Home Assistant or py-opendisplay over BLE and LAN
common:
  tags: [opendisplay]
tests:
  sample.opendisplay.ble:
    build_only: true
    # Blobs are not fetched in CI; link-only stubs stand in for them.
    extra_configs:
      - CONFIG_BUILD_ONLY_NO_BLOBS=y
    platform_allow:
      - reterminal_e1001/esp32s3/procpu
      - m5stack_core2/esp32/procpu
    integration_platforms:
      - reterminal_e1001/esp32s3/procpu
      - m5stack_core2/esp32/procpu
  sample.opendisplay.ble_wifi:
    build_only: true
    extra_args: EXTRA_CONF_FILE=overlay-wifi.conf
    extra_configs:
      - CONFIG_BUILD_ONLY_NO_BLOBS=y
    platform_allow:
      - reterminal_e1001/esp32s3/procpu
    integration_platforms:
      - reterminal_e1001/esp32s3/procpu
  sample.opendisplay.lan:
    # Uploads an image with py-opendisplay over the host's loopback.
    harness: pytest
    harness_config:
      pytest_root:
        - pytest/test_upload.py
    extra_args: CONF_FILE=native_sim.conf
    platform_allow:
      - native_sim
    integration_platforms:
      - native_sim
```

## prj.conf
```kconfig
CONFIG_DISPLAY=y
CONFIG_OPENDISPLAY=y
CONFIG_OPENDISPLAY_ZLIB=y
CONFIG_LOG=y

# BLE transport; host config persists in settings.
CONFIG_BT=y
CONFIG_BT_PERIPHERAL=y
CONFIG_BT_DEVICE_NAME="OpenDisplay"
CONFIG_OPENDISPLAY_BLE=y
CONFIG_FLASH=y
CONFIG_FLASH_MAP=y
CONFIG_NVS=y
CONFIG_SETTINGS=y
CONFIG_SETTINGS_NVS=y
CONFIG_REBOOT=y
```

## native_sim.conf
```kconfig
# native_sim: LAN only, over the host's sockets (NSOS). Used in place of
# prj.conf: there is no BLE controller or display hardware.
CONFIG_DISPLAY=y
CONFIG_OPENDISPLAY=y
CONFIG_OPENDISPLAY_ZLIB=y
CONFIG_LOG=y
CONFIG_SDL_DISPLAY=n
CONFIG_TEST_RANDOM_GENERATOR=y
CONFIG_NETWORKING=y
CONFIG_NET_IPV4=y
CONFIG_NET_IPV6=n
CONFIG_NET_TCP=y
CONFIG_NET_SOCKETS=y
CONFIG_NET_DRIVERS=y
CONFIG_ETH_NATIVE_TAP=n
CONFIG_NET_SOCKETS_OFFLOAD=y
CONFIG_NET_NATIVE_OFFLOADED_SOCKETS=y
CONFIG_OPENDISPLAY_LAN=y
```

## overlay-wifi.conf
```kconfig
# LAN transport over Wi-Fi: set the SSID and password, or use the
# "wifi cred" shell commands with WIFI_CREDENTIALS_BACKEND_SETTINGS.
CONFIG_WIFI=y
CONFIG_NETWORKING=y
CONFIG_NET_IPV4=y
CONFIG_NET_TCP=y
CONFIG_NET_DHCPV4=y
CONFIG_NET_SOCKETS=y
CONFIG_NET_L2_WIFI_MGMT=y
CONFIG_WIFI_CREDENTIALS=y
CONFIG_WIFI_CREDENTIALS_STATIC=y
CONFIG_WIFI_CREDENTIALS_STATIC_SSID="my-network"
CONFIG_WIFI_CREDENTIALS_STATIC_PASSWORD="my-password"
CONFIG_OPENDISPLAY_LAN=y
CONFIG_MDNS_RESPONDER=y
CONFIG_DNS_SD=y
CONFIG_NET_HOSTNAME_ENABLE=y
CONFIG_NET_HOSTNAME="opendisplay"
CONFIG_NET_HOSTNAME_UNIQUE=y
```

## boards/native_sim.overlay
```dts
/ {
	chosen {
		zephyr,display = &dummy_display;
	};

	dummy_display: dummy-display {
		compatible = "zephyr,dummy-dc";
		height = <128>;
		width = <296>;
	};
};
```

## src/main.c
```c
/*
 * OpenDisplay receiver: Home Assistant or py-opendisplay push images to the
 * zephyr,display device over BLE and, when networking is on, over LAN.
 *
 * SPDX-License-Identifier: Apache-2.0
 */

#include <zephyr/bluetooth/bluetooth.h>
#include <zephyr/kernel.h>
#include <zephyr/logging/log.h>
#include <zephyr/net/net_if.h>

#include <zephyr/net/dhcpv4.h>
#include <zephyr/net/net_mgmt.h>
#include <zephyr/net/wifi_mgmt.h>
#include <zephyr/opendisplay/opendisplay.h>
#include <zephyr/settings/settings.h>

LOG_MODULE_REGISTER(app, LOG_LEVEL_INF);

static void image_received(void)
{
	LOG_INF("image received, refreshing");
}

static void refresh_done(int err)
{
	LOG_INF("refresh done: %d", err);
}

static const struct opendisplay_callbacks callbacks = {
	.image_received = image_received,
	.refresh_done = refresh_done,
};

static void lan_start(void)
{
	struct net_if *iface = net_if_get_default();

	if (iface == NULL) {
		return;
	}
	if (IS_ENABLED(CONFIG_NET_DHCPV4)) {
		net_dhcpv4_start(iface);
	}
#if defined(CONFIG_WIFI_CREDENTIALS_CONNECT_STORED)
	if (net_mgmt(NET_REQUEST_WIFI_CONNECT_STORED, iface, NULL, 0) != 0) {
		LOG_ERR("Wi-Fi connect failed");
	}
#endif
}

int main(void)
{
	int err;

	opendisplay_set_callbacks(&callbacks);

	if (IS_ENABLED(CONFIG_SETTINGS)) {
		err = settings_subsys_init();
		if (err != 0) {
			LOG_ERR("settings: %d", err);
		}
	}

	if (IS_ENABLED(CONFIG_OPENDISPLAY_BLE)) {
		err = bt_enable(NULL);
		if (err != 0) {
			LOG_ERR("bt_enable: %d", err);
			return 0;
		}
		if (IS_ENABLED(CONFIG_SETTINGS)) {
			(void)settings_load();
		}
		err = opendisplay_ble_start();
		if (err != 0) {
			LOG_ERR("advertising: %d", err);
		}
	} else if (IS_ENABLED(CONFIG_SETTINGS)) {
		(void)settings_load();
	}

	/* The LAN server starts by itself once the interface is up. */
	if (IS_ENABLED(CONFIG_OPENDISPLAY_LAN)) {
		lan_start();
	}

	return 0;
}
```
