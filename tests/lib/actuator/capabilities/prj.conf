## CMakeLists.txt
```
cmake_minimum_required(VERSION 3.20.0)
find_package(Zephyr REQUIRED HINTS $ENV{ZEPHYR_BASE})
project(actuator_capabilities)
target_sources(app PRIVATE src/main.c)
```

## prj.conf
```kconfig
CONFIG_ZTEST=y
CONFIG_ACTUATOR=y
```

## src/main.c
```c
/*
 * Copyright (c) 2026 Richard Osterloh <richard.osterloh@gmail.com>
 * SPDX-License-Identifier: Apache-2.0
 */

#include <errno.h>
#include <zephyr/ztest.h>
#include <zephyr/actuator/actuator_types.h>
#include <zephyr/actuator/internal/capabilities.h>

ZTEST_SUITE(actuator_caps, NULL, NULL, NULL, NULL, NULL);

ZTEST(actuator_caps, test_mode_supported)
{
	const uint32_t caps = ACTUATOR_CAP_POSITION | ACTUATOR_CAP_VELOCITY;
	zassert_equal(actuator_cap_check_mode(caps, ACTUATOR_MODE_POSITION), 0);
	zassert_equal(actuator_cap_check_mode(caps, ACTUATOR_MODE_VELOCITY), 0);
	zassert_equal(actuator_cap_check_mode(caps, ACTUATOR_MODE_EFFORT), -ENOTSUP);
	zassert_equal(actuator_cap_check_mode(caps, ACTUATOR_MODE_DISABLED), -EINVAL);
}

ZTEST(actuator_caps, test_all_modes_caps)
{
	const uint32_t caps = ACTUATOR_CAP_POSITION | ACTUATOR_CAP_VELOCITY | ACTUATOR_CAP_EFFORT;
	zassert_equal(actuator_cap_check_mode(caps, ACTUATOR_MODE_EFFORT), 0);
}

ZTEST(actuator_caps, test_duty_needs_its_own_cap)
{
	zassert_equal(actuator_cap_check_mode(ACTUATOR_CAP_VELOCITY, ACTUATOR_MODE_DUTY), -ENOTSUP);
	zassert_equal(actuator_cap_check_mode(ACTUATOR_CAP_DUTY, ACTUATOR_MODE_DUTY), 0);
}
```
