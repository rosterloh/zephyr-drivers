## CMakeLists.txt
```
# Copyright (c) 2026 Richard Osterloh
# SPDX-License-Identifier: Apache-2.0

cmake_minimum_required(VERSION 3.20.0)
find_package(Zephyr REQUIRED HINTS $ENV{ZEPHYR_BASE})
project(esp32_csi_build)

target_sources(app PRIVATE src/main.c)
```

## prj.conf
```kconfig
CONFIG_VIDEO=y
CONFIG_SOC_FAMILY_ESPRESSIF_SPIRAM=y
```

## src/main.c
```c
/*
 * Copyright (c) 2026 Richard Osterloh
 * SPDX-License-Identifier: Apache-2.0
 */

/* Build-only: the receiver is pulled in by the shield's devicetree. */
int main(void)
{
	return 0;
}
```
