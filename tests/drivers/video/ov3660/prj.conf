## CMakeLists.txt
```
# Copyright (c) 2026 Richard Osterloh
# SPDX-License-Identifier: Apache-2.0

cmake_minimum_required(VERSION 3.20.0)
find_package(Zephyr REQUIRED HINTS $ENV{ZEPHYR_BASE})
project(ov3660_test)

target_sources(app PRIVATE src/main.c)
```

## prj.conf
```kconfig
CONFIG_ZTEST=y
CONFIG_VIDEO=y
```

## src/main.c
```c
/*
 * Copyright (c) 2026 Richard Osterloh <richard.osterloh@gmail.com>
 * SPDX-License-Identifier: Apache-2.0
 *
 * Build check: the board's camera chain (LCD_CAM DVP + OV3660) links and
 * offers JPEG. Needs the board to run.
 */

#include <zephyr/device.h>
#include <zephyr/drivers/video.h>
#include <zephyr/ztest.h>

ZTEST(ov3660, test_jpeg_caps)
{
	const struct device *dev = DEVICE_DT_GET(DT_CHOSEN(zephyr_camera));
	struct video_caps caps = {.type = VIDEO_BUF_TYPE_OUTPUT};

	zassert_true(device_is_ready(dev));
	zassert_ok(video_get_caps(dev, &caps));
	zassert_equal(caps.format_caps[0].pixelformat, VIDEO_PIX_FMT_JPEG);
}

ZTEST_SUITE(ov3660, NULL, NULL, NULL, NULL, NULL);
```
