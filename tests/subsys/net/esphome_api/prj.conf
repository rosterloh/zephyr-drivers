## CMakeLists.txt
```
cmake_minimum_required(VERSION 3.20.0)
find_package(Zephyr REQUIRED HINTS $ENV{ZEPHYR_BASE})
project(esphome_api_test)
target_sources(app PRIVATE src/main.c)
# The test sources include <api.pb.h>, generated for the esphome_api library.
add_dependencies(app nanopb_generated_headers)
target_sources_ifdef(CONFIG_ESPHOME_API_MDNS app PRIVATE src/mdns.c)
if(CONFIG_ESPHOME_API_NOISE)
  target_sources(app PRIVATE src/noise.c)
  target_include_directories(app PRIVATE ${ZEPHYR_ZEPHYR_DRIVERS_MODULE_DIR}/subsys/net/lib/esphome_api)
else()
  target_sources(app PRIVATE src/server.c)
endif()
```

## prj.conf
```kconfig
CONFIG_ZTEST=y
CONFIG_TEST_RANDOM_GENERATOR=y
CONFIG_NETWORKING=y
CONFIG_NET_TEST=y
CONFIG_NET_DRIVERS=y
CONFIG_NET_LOOPBACK=y
CONFIG_NET_IPV4=y
CONFIG_NET_IPV6=n
CONFIG_NET_TCP=y
CONFIG_NET_SOCKETS=y
CONFIG_ESPHOME_API=y
CONFIG_ESPHOME_API_IDLE_TIMEOUT=2
CONFIG_ZTEST_STACK_SIZE=4096
CONFIG_NET_CONTEXT_RCVTIMEO=y
CONFIG_LOG=y
CONFIG_ESPHOME_API_LOG_LEVEL_DBG=y
CONFIG_NET_MAX_CONTEXTS=24
CONFIG_NET_MAX_CONN=24
CONFIG_ZVFS_OPEN_MAX=24
```

## ipv6.conf
```kconfig
CONFIG_NET_IPV6=y
```

## mdns.conf
```kconfig
CONFIG_NET_HOSTNAME_ENABLE=y
CONFIG_NET_HOSTNAME="zephyr-test"
CONFIG_DNS_SD=y
CONFIG_MDNS_RESPONDER=y
CONFIG_NET_IPV4_IGMP=y
CONFIG_ESPHOME_API_FRIENDLY_NAME="Zephyr Test"
```

## noise.conf
```kconfig
CONFIG_ESPHOME_API_NOISE=y
# base64 of bytes 00..1f, the key in src/noise.c.
CONFIG_ESPHOME_API_NOISE_PSK="AAECAwQFBgcICQoLDA0ODxAREhMUFRYXGBkaGxwdHh8="
CONFIG_MAIN_STACK_SIZE=4096
```

## src/main.c
```c
/*
 * SPDX-License-Identifier: Apache-2.0
 */

#include <string.h>
#include <zephyr/ztest.h>
#include <zephyr/net/esphome_api.h>
#include <pb_encode.h>
#include <pb_decode.h>
#include <api.pb.h>

ZTEST(esphome_api_proto, test_hello_response_encode)
{
	HelloResponse resp = {
		.api_version_major = ESPHOME_API_VERSION_MAJOR,
		.api_version_minor = ESPHOME_API_VERSION_MINOR,
		.name = "x",
	};
	/* major=1, minor=19, name="x"; empty server_info omitted (proto3) */
	static const uint8_t expected[] = {0x08, 0x01, 0x10, 0x13, 0x22, 0x01, 'x'};
	uint8_t buf[HelloResponse_size];
	pb_ostream_t os = pb_ostream_from_buffer(buf, sizeof(buf));

	zassert_true(pb_encode(&os, HelloResponse_fields, &resp));
	zassert_equal(os.bytes_written, sizeof(expected));
	zassert_mem_equal(buf, expected, sizeof(expected));
}

ZTEST(esphome_api_proto, test_hello_request_decode)
{
	static const uint8_t wire[] = {0x0a, 0x02, 'H', 'A', 0x10, 0x01, 0x18, 0x13};
	HelloRequest req = HelloRequest_init_zero;
	pb_istream_t is = pb_istream_from_buffer(wire, sizeof(wire));

	zassert_true(pb_decode(&is, HelloRequest_fields, &req));
	zassert_str_equal(req.client_info, "HA");
	zassert_equal(req.api_version_major, 1);
	zassert_equal(req.api_version_minor, 19);
}

ZTEST(esphome_api_proto, test_client_info_too_long)
{
	uint8_t wire[2 + sizeof(((HelloRequest *)0)->client_info)];
	HelloRequest req;
	pb_istream_t is;

	/* one byte more than fits with the NUL */
	wire[0] = 0x0a;
	wire[1] = sizeof(wire) - 2;
	memset(&wire[2], 'a', sizeof(wire) - 2);
	is = pb_istream_from_buffer(wire, sizeof(wire));
	zassert_false(pb_decode(&is, HelloRequest_fields, &req));
}

ZTEST(esphome_api_proto, test_switch_command_decode)
{
	static const uint8_t wire[] = {0x0d, 0x78, 0x56, 0x34, 0x12, 0x10, 0x01};
	SwitchCommandRequest cmd = SwitchCommandRequest_init_zero;
	pb_istream_t is = pb_istream_from_buffer(wire, sizeof(wire));

	zassert_true(pb_decode(&is, SwitchCommandRequest_fields, &cmd));
	zassert_equal(cmd.key, 0x12345678);
	zassert_true(cmd.state);
}

ZTEST(esphome_api_proto, test_msgids)
{
	zassert_equal(HelloRequest_msgid, 1);
	zassert_equal(HelloResponse_msgid, 2);
	zassert_equal(ListEntitiesDoneResponse_msgid, 19);
	zassert_equal(ButtonCommandRequest_msgid, 62);
}

ZTEST_SUITE(esphome_api_proto, NULL, NULL, NULL, NULL, NULL);
```

## src/mdns.c
```c
/*
 * Checks the DNS-SD record the mDNS responder advertises.
 *
 * SPDX-License-Identifier: Apache-2.0
 */

#include <string.h>
#include <zephyr/net/dns_sd.h>
#include <zephyr/version.h>
#include <zephyr/net/net_ip.h>
#include <zephyr/ztest.h>

static const struct dns_sd_rec *find_rec(void)
{
	STRUCT_SECTION_FOREACH(dns_sd_rec, rec) {
		if (strcmp(rec->service, "_esphomelib") == 0) {
			return rec;
		}
	}
	return NULL;
}

/* Value of TXT key @p key, or NULL. */
static const char *txt_get(const struct dns_sd_rec *rec, const char *key, char *out, size_t size)
{
	size_t klen = strlen(key);

	for (size_t pos = 0; pos < rec->text_size;) {
		size_t len = (uint8_t)rec->text[pos];
		const char *kv = &rec->text[pos + 1];

		zassert_true(pos + 1 + len <= rec->text_size, "TXT string overruns record");
		if (len > klen && strncmp(kv, key, klen) == 0 && kv[klen] == '=') {
			zassert_true(len - klen <= size);
			memcpy(out, kv + klen + 1, len - klen - 1);
			out[len - klen - 1] = '\0';
			return out;
		}
		pos += 1 + len;
	}
	return NULL;
}

ZTEST(esphome_api_mdns, test_record)
{
	const struct dns_sd_rec *rec = find_rec();

	zassert_not_null(rec);
	zassert_str_equal(rec->instance, CONFIG_NET_HOSTNAME);
	zassert_str_equal(rec->proto, "_tcp");
	zassert_str_equal(rec->domain, "local");
	zassert_equal(net_ntohs(*rec->port), CONFIG_ESPHOME_API_PORT);
}

ZTEST(esphome_api_mdns, test_txt)
{
	const struct dns_sd_rec *rec = find_rec();
	char val[64];

	zassert_not_null(rec);
	zassert_not_null(txt_get(rec, "mac", val, sizeof(val)));
	zassert_equal(strlen(val), 12);
	for (int i = 0; i < 12; i++) {
		zassert_true((val[i] >= '0' && val[i] <= '9') || (val[i] >= 'a' && val[i] <= 'f'),
			     "mac must be lowercase hex: %s", val);
	}
	zassert_not_null(txt_get(rec, "version", val, sizeof(val)));
	zassert_str_equal(val, "Zephyr " KERNEL_VERSION_STRING);
	zassert_not_null(txt_get(rec, "board", val, sizeof(val)));
	zassert_str_equal(val, CONFIG_BOARD);
	zassert_not_null(txt_get(rec, "friendly_name", val, sizeof(val)));
	zassert_str_equal(val, CONFIG_ESPHOME_API_FRIENDLY_NAME);
	zassert_equal(txt_get(rec, "api_encryption", val, sizeof(val)) != NULL,
		      IS_ENABLED(CONFIG_ESPHOME_API_NOISE));
}

ZTEST_SUITE(esphome_api_mdns, NULL, NULL, NULL, NULL, NULL);
```

## src/noise.c
```c
/*
 * Noise: known-answer vectors from the Python noise library aioesphomeapi uses, then the
 * server over loopback with this file playing the initiator.
 *
 * SPDX-License-Identifier: Apache-2.0
 */

#include <errno.h>
#include <string.h>
#include <zephyr/kernel.h>
#include <zephyr/net/esphome_api.h>
#include <zephyr/net/socket.h>
#include <zephyr/sys/byteorder.h>
#include <zephyr/ztest.h>
#include <pb_decode.h>
#include <pb_encode.h>
#include <api.pb.h>
#include <noise.h>

/* gen_noise_vectors.py: psk 00..1f, initiator e 0x11.., responder e 0x22..; Ping both ways. */
static const uint8_t psk[] = {0x00, 0x01, 0x02, 0x03, 0x04, 0x05, 0x06, 0x07, 0x08, 0x09, 0x0a,
			      0x0b, 0x0c, 0x0d, 0x0e, 0x0f, 0x10, 0x11, 0x12, 0x13, 0x14, 0x15,
			      0x16, 0x17, 0x18, 0x19, 0x1a, 0x1b, 0x1c, 0x1d, 0x1e, 0x1f};
static const uint8_t ie_priv[] = {0x11, 0x11, 0x11, 0x11, 0x11, 0x11, 0x11, 0x11, 0x11, 0x11, 0x11,
				  0x11, 0x11, 0x11, 0x11, 0x11, 0x11, 0x11, 0x11, 0x11, 0x11, 0x11,
				  0x11, 0x11, 0x11, 0x11, 0x11, 0x11, 0x11, 0x11, 0x11, 0x11};
static const uint8_t re_priv[] = {0x22, 0x22, 0x22, 0x22, 0x22, 0x22, 0x22, 0x22, 0x22, 0x22, 0x22,
				  0x22, 0x22, 0x22, 0x22, 0x22, 0x22, 0x22, 0x22, 0x22, 0x22, 0x22,
				  0x22, 0x22, 0x22, 0x22, 0x22, 0x22, 0x22, 0x22, 0x22, 0x22};
static const uint8_t msg1[] = {0x7b, 0x4e, 0x90, 0x9b, 0xbe, 0x7f, 0xfe, 0x44, 0xc4, 0x65,
			       0xa2, 0x20, 0x03, 0x7d, 0x60, 0x8e, 0xe3, 0x58, 0x97, 0xd3,
			       0x1e, 0xf9, 0x72, 0xf0, 0x7f, 0x74, 0x89, 0x2c, 0xb0, 0xf7,
			       0x3f, 0x13, 0xd1, 0xbc, 0x1a, 0x38, 0xb6, 0x79, 0x36, 0x85,
			       0xdc, 0x7e, 0x2f, 0xfd, 0xf8, 0xea, 0x09, 0x33};
static const uint8_t msg2[] = {0x0f, 0xaa, 0x68, 0x4e, 0xd2, 0x88, 0x67, 0xb9, 0x7f, 0x4a,
			       0x6a, 0x2d, 0xee, 0x5d, 0xf8, 0xce, 0x97, 0x4e, 0x76, 0xb7,
			       0x01, 0x8e, 0x3f, 0x22, 0xa1, 0xc4, 0xcf, 0x26, 0x78, 0x57,
			       0x0f, 0x20, 0x73, 0x36, 0xb9, 0x59, 0x33, 0xb3, 0x21, 0xb1,
			       0xae, 0x86, 0x67, 0x3f, 0x68, 0x9f, 0x5c, 0x9f};
static const uint8_t c2s[] = {0x08, 0x2a, 0x88, 0xd4, 0x45, 0x7b, 0x72, 0x64, 0x6c, 0xa1,
			      0xef, 0x30, 0x4b, 0xe3, 0x4f, 0x8f, 0xfa, 0xc1, 0xf6, 0x59};
static const uint8_t s2c[] = {0xd9, 0x42, 0x3b, 0xf4, 0x8b, 0xde, 0xa6, 0x2b, 0xb1, 0x0b,
			      0xbd, 0x87, 0xa7, 0xfb, 0x5e, 0xcc, 0x26, 0x72, 0x10, 0x50};

static psa_key_id_t import_e(const uint8_t priv[32])
{
	psa_key_attributes_t attr = PSA_KEY_ATTRIBUTES_INIT;
	psa_key_id_t id;

	psa_set_key_usage_flags(&attr, PSA_KEY_USAGE_DERIVE);
	psa_set_key_algorithm(&attr, PSA_ALG_ECDH);
	psa_set_key_type(&attr, PSA_KEY_TYPE_ECC_KEY_PAIR(PSA_ECC_FAMILY_MONTGOMERY));
	psa_set_key_bits(&attr, 255);
	zassert_equal(psa_import_key(&attr, priv, 32, &id), PSA_SUCCESS);

	return id;
}

/* Initiator side, as aioesphomeapi runs it; the server tests use it too. */
static void initiator_write(struct noise_ss *ss, const uint8_t key[32], psa_key_id_t e,
			    uint8_t m1[NOISE_HS_LEN])
{
	size_t olen;

	esphome_noise_init(ss);
	zassert_ok(esphome_noise_mix_key_and_hash(ss, key, 32));
	zassert_equal(psa_export_public_key(e, m1, 32, &olen), PSA_SUCCESS);
	zassert_ok(esphome_noise_mix_hash(ss, m1, 32));
	zassert_ok(esphome_noise_mix_key(ss, m1, 32));
	zassert_ok(esphome_noise_encrypt_and_hash(ss, &m1[32], 0));
}

static void initiator_read(struct noise_ss *ss, psa_key_id_t e, const uint8_t m2[NOISE_HS_LEN],
			   struct noise_cs *c1, struct noise_cs *c2)
{
	uint8_t tag[NOISE_TAG_LEN];
	uint8_t dh[32];
	size_t olen;

	zassert_ok(esphome_noise_mix_hash(ss, m2, 32));
	zassert_ok(esphome_noise_mix_key(ss, m2, 32));
	zassert_equal(psa_raw_key_agreement(PSA_ALG_ECDH, e, m2, 32, dh, sizeof(dh), &olen),
		      PSA_SUCCESS);
	psa_destroy_key(e);
	zassert_ok(esphome_noise_mix_key(ss, dh, sizeof(dh)));
	memcpy(tag, &m2[32], sizeof(tag));
	zassert_ok(esphome_noise_decrypt_and_hash(ss, tag, sizeof(tag)));
	zassert_ok(esphome_noise_split(ss, c1, c2));
}

ZTEST(esphome_api_noise, test_initiator_kat)
{
	struct noise_ss ss;
	struct noise_cs c1, c2;
	psa_key_id_t e = import_e(ie_priv);
	uint8_t m1[NOISE_HS_LEN];
	uint8_t frame[sizeof(s2c)];

	initiator_write(&ss, psk, e, m1);
	zassert_mem_equal(m1, msg1, sizeof(msg1));
	initiator_read(&ss, e, msg2, &c1, &c2);

	memcpy(frame, "\x00\x07\x00\x00", 4);
	zassert_ok(esphome_noise_encrypt(&c1, frame, 4));
	zassert_mem_equal(frame, c2s, sizeof(c2s));
	memcpy(frame, s2c, sizeof(s2c));
	zassert_ok(esphome_noise_decrypt(&c2, frame, sizeof(frame)));
	zassert_mem_equal(frame, "\x00\x08\x00\x00", 4);

	esphome_noise_cs_destroy(&c1);
	esphome_noise_cs_destroy(&c2);
}

ZTEST(esphome_api_noise, test_respond_kat)
{
	struct noise_cs rx, tx;
	uint8_t out[NOISE_HS_LEN];
	uint8_t frame[sizeof(c2s)];

	zassert_ok(esphome_noise_respond(psk, msg1, import_e(re_priv), out, &rx, &tx));
	zassert_mem_equal(out, msg2, sizeof(msg2));

	memcpy(frame, c2s, sizeof(c2s));
	zassert_ok(esphome_noise_decrypt(&rx, frame, sizeof(frame)));
	zassert_mem_equal(frame, "\x00\x07\x00\x00", 4);
	/* Replayed frame: the nonce has moved on. */
	memcpy(frame, c2s, sizeof(c2s));
	zassert_equal(esphome_noise_decrypt(&rx, frame, sizeof(frame)), -EBADMSG);

	memcpy(frame, "\x00\x08\x00\x00", 4);
	zassert_ok(esphome_noise_encrypt(&tx, frame, 4));
	zassert_mem_equal(frame, s2c, sizeof(s2c));

	esphome_noise_cs_destroy(&rx);
	esphome_noise_cs_destroy(&tx);
}

ZTEST(esphome_api_noise, test_respond_wrong_psk)
{
	struct noise_cs rx = {0}, tx = {0};
	uint8_t bad[32];
	uint8_t out[NOISE_HS_LEN];

	memcpy(bad, psk, sizeof(bad));
	bad[0] ^= 1;
	zassert_equal(esphome_noise_respond(bad, msg1, import_e(re_priv), out, &rx, &tx), -EBADMSG);
	zassert_equal(rx.key, PSA_KEY_ID_NULL);
}

/* Server over loopback. */

static int open_fd = -1;

static int connect_server(void)
{
	struct net_sockaddr_in addr = {
		.sin_family = NET_AF_INET,
		.sin_port = net_htons(CONFIG_ESPHOME_API_PORT),
	};
	struct zsock_timeval tv = {.tv_sec = 1};
	int fd = zsock_socket(NET_AF_INET, NET_SOCK_STREAM, NET_IPPROTO_TCP);

	zassert_true(fd >= 0);
	open_fd = fd;
	zassert_equal(zsock_inet_pton(NET_AF_INET, "127.0.0.1", &addr.sin_addr), 1);
	zassert_ok(zsock_setsockopt(fd, ZSOCK_SOL_SOCKET, ZSOCK_SO_RCVTIMEO, &tv, sizeof(tv)));
	zassert_ok(zsock_connect(fd, (struct net_sockaddr *)&addr, sizeof(addr)), "connect: %d",
		   errno);

	return fd;
}

static int recv_exact(int fd, uint8_t *dst, size_t len)
{
	while (len > 0) {
		ssize_t n = zsock_recv(fd, dst, len, 0);

		if (n <= 0) {
			return n == 0 ? -ECONNRESET : -errno;
		}
		dst += n;
		len -= n;
	}

	return 0;
}

/* One 0x01 frame into buf; returns its length. */
static int recv_noise_frame(int fd, uint8_t *buf, size_t size)
{
	uint8_t hdr[3];
	size_t len;
	int ret = recv_exact(fd, hdr, sizeof(hdr));

	if (ret < 0) {
		return ret;
	}
	zassert_equal(hdr[0], 0x01);
	len = sys_get_be16(&hdr[1]);
	zassert_true(len <= size);
	ret = recv_exact(fd, buf, len);

	return ret < 0 ? ret : (int)len;
}

static void send_noise_frame(int fd, const uint8_t *payload, size_t len)
{
	uint8_t hdr[3] = {0x01, len >> 8, len & 0xff};

	zassert_equal(zsock_send(fd, hdr, sizeof(hdr), 0), sizeof(hdr));
	if (len > 0) {
		zassert_equal(zsock_send(fd, payload, len, 0), len);
	}
}

static void expect_closed(int fd)
{
	uint8_t b;

	zassert_true(zsock_recv(fd, &b, 1, 0) <= 0);
	zsock_close(fd);
	open_fd = -1;
}

/* Hello and handshake as aioesphomeapi does them; returns the server's reply frame. */
static int handshake(int fd, const uint8_t key[32], struct noise_ss *ss, psa_key_id_t *e,
		     uint8_t *reply, size_t size)
{
	uint8_t m1[1 + NOISE_HS_LEN] = {0x00};
	char hello[64];
	int len;

	zassert_ok(esphome_noise_generate_e(e, &m1[1]));
	initiator_write(ss, key, *e, &m1[1]);

	send_noise_frame(fd, NULL, 0);
	send_noise_frame(fd, m1, sizeof(m1));

	len = recv_noise_frame(fd, hello, sizeof(hello));
	zassert_true(len > 0);
	zassert_equal(hello[0], 0x01, "chosen protocol");
	zassert_str_equal(&hello[1], CONFIG_ESPHOME_API_DEVICE_NAME);
	zassert_equal(strlen(&hello[1 + strlen(&hello[1]) + 1]), 12, "mac");

	return recv_noise_frame(fd, reply, size);
}

ZTEST(esphome_api_noise, test_server_ping)
{
	int fd = connect_server();
	struct noise_ss ss;
	struct noise_cs c1, c2;
	psa_key_id_t e;
	uint8_t frame[64];
	int len;

	len = handshake(fd, psk, &ss, &e, frame, sizeof(frame));
	zassert_equal(len, 1 + NOISE_HS_LEN);
	zassert_equal(frame[0], 0x00);
	initiator_read(&ss, e, &frame[1], &c1, &c2);

	/* Two pings check that both nonces advance. */
	for (int i = 0; i < 2; i++) {
		sys_put_be16(PingRequest_msgid, frame);
		sys_put_be16(0, &frame[2]);
		zassert_ok(esphome_noise_encrypt(&c1, frame, 4));
		send_noise_frame(fd, frame, 4 + NOISE_TAG_LEN);

		len = recv_noise_frame(fd, frame, sizeof(frame));
		zassert_equal(len, 4 + NOISE_TAG_LEN);
		zassert_ok(esphome_noise_decrypt(&c2, frame, len));
		zassert_equal(sys_get_be16(frame), PingResponse_msgid);
		zassert_equal(sys_get_be16(&frame[2]), 0);
	}

	esphome_noise_cs_destroy(&c1);
	esphome_noise_cs_destroy(&c2);
	zsock_close(fd);
	open_fd = -1;
}

static uint8_t image[1000];

static int get_image_cb(struct esphome_entity *ent, const uint8_t **data, size_t *len)
{
	*data = image;
	*len = sizeof(image);
	return 0;
}

ESPHOME_CAMERA_DEFINE(cam, .get_image = get_image_cb);

static void send_msg(int fd, struct noise_cs *cs, uint16_t type, const pb_msgdesc_t *fields,
		     const void *msg)
{
	uint8_t frame[128];
	pb_ostream_t os = pb_ostream_from_buffer(&frame[4], sizeof(frame) - 4 - NOISE_TAG_LEN);

	zassert_true(pb_encode(&os, fields, msg));
	sys_put_be16(type, frame);
	sys_put_be16(os.bytes_written, &frame[2]);
	zassert_ok(esphome_noise_encrypt(cs, frame, 4 + os.bytes_written));
	send_noise_frame(fd, frame, 4 + os.bytes_written + NOISE_TAG_LEN);
}

/* Decrypts one frame in place; returns its message length, the body at &frame[4]. */
static int recv_msg(int fd, struct noise_cs *cs, uint8_t *frame, size_t size, uint16_t type)
{
	int len = recv_noise_frame(fd, frame, size);

	zassert_true(len >= 4 + NOISE_TAG_LEN, "recv %d", len);
	zassert_ok(esphome_noise_decrypt(cs, frame, len));
	zassert_equal(sys_get_be16(frame), type, "got %u", sys_get_be16(frame));

	return sys_get_be16(&frame[2]);
}

struct image_rx {
	uint8_t data[sizeof(image)];
	size_t len;
};

static bool decode_chunk(pb_istream_t *is, const pb_field_t *field, void **arg)
{
	struct image_rx *rx = *arg;
	size_t n = is->bytes_left;

	if (rx->len + n > sizeof(rx->data) || !pb_read(is, &rx->data[rx->len], n)) {
		return false;
	}
	rx->len += n;
	return true;
}

/* The image goes out in chunks, each its own encrypted frame. */
ZTEST(esphome_api_noise, test_server_camera)
{
	static uint8_t frame[1024];
	static struct image_rx rx;
	HelloRequest hello = {.api_version_major = 1, .api_version_minor = 19};
	CameraImageRequest req = {.single = true};
	CameraImageResponse m;
	int fd = connect_server();
	struct noise_ss ss;
	struct noise_cs c1, c2;
	psa_key_id_t e;
	int frames = 0;
	int len;

	for (size_t i = 0; i < sizeof(image); i++) {
		image[i] = (uint8_t)(i * 13U);
	}

	len = handshake(fd, psk, &ss, &e, frame, sizeof(frame));
	zassert_equal(len, 1 + NOISE_HS_LEN);
	initiator_read(&ss, e, &frame[1], &c1, &c2);

	send_msg(fd, &c1, HelloRequest_msgid, HelloRequest_fields, &hello);
	(void)recv_msg(fd, &c2, frame, sizeof(frame), HelloResponse_msgid);

	send_msg(fd, &c1, CameraImageRequest_msgid, CameraImageRequest_fields, &req);
	do {
		pb_istream_t is;

		len = recv_msg(fd, &c2, frame, sizeof(frame), CameraImageResponse_msgid);
		is = pb_istream_from_buffer(&frame[4], len);
		m = (CameraImageResponse){.data = {.funcs.decode = decode_chunk, .arg = &rx}};
		zassert_true(pb_decode(&is, CameraImageResponse_fields, &m));
		frames++;
	} while (!m.done);

	zassert_equal(frames, 2);
	zassert_equal(rx.len, sizeof(image));
	zassert_mem_equal(rx.data, image, sizeof(image));

	esphome_noise_cs_destroy(&c1);
	esphome_noise_cs_destroy(&c2);
	zsock_close(fd);
	open_fd = -1;
}

ZTEST(esphome_api_noise, test_server_wrong_psk)
{
	int fd = connect_server();
	struct noise_ss ss;
	psa_key_id_t e;
	uint8_t bad[32] = {0};
	uint8_t frame[64];
	int len;

	len = handshake(fd, bad, &ss, &e, frame, sizeof(frame));
	psa_destroy_key(e);
	zassert_true(len > 1);
	frame[len] = '\0';
	zassert_equal(frame[0], 0x01, "reject marker");
	zassert_str_equal((char *)&frame[1], "Handshake MAC failure");
	expect_closed(fd);
}

ZTEST(esphome_api_noise, test_server_rejects_plaintext)
{
	int fd = connect_server();
	/* Plaintext HelloRequest with an empty body. */
	const uint8_t hello[] = {0x00, 0x00, 0x01};
	uint8_t frame[64];
	int len;

	zassert_equal(zsock_send(fd, hello, sizeof(hello), 0), sizeof(hello));
	/* aioesphomeapi's plaintext client reads the 0x01 marker as "requires encryption". */
	len = recv_noise_frame(fd, frame, sizeof(frame) - 1);
	zassert_true(len > 1);
	zassert_equal(frame[0], 0x01);
	expect_closed(fd);
}

static void *setup(void)
{
	zassert_equal(psa_crypto_init(), PSA_SUCCESS);
	/* Let the server thread open its listener. */
	k_sleep(K_MSEC(100));
	return NULL;
}

static void after(void *fixture)
{
	if (open_fd >= 0) {
		zsock_close(open_fd);
		open_fd = -1;
		k_sleep(K_MSEC(50));
	}
}

ZTEST_SUITE(esphome_api_noise, NULL, setup, NULL, after, NULL);
```

## src/server.c
```c
/*
 * Drives the server over loopback the way aioesphomeapi does.
 *
 * SPDX-License-Identifier: Apache-2.0
 */

#include <errno.h>
#include <zephyr/kernel.h>
#include <zephyr/net/esphome_api.h>
#include <zephyr/net/socket.h>
#include <zephyr/ztest.h>
#include <pb_decode.h>
#include <pb_encode.h>
#include <api.pb.h>

/* FNV-1 of the object_id, as ESPHome computes it (checked with a Python port). */
#define KEY_TEMPERATURE 0x35a123f9
#define KEY_STOPPED     0xad23af94
#define KEY_RELAY       0xd3a92fe4
#define KEY_RESET       0xef75803a
#define KEY_CAM         0x3a97a3a2

#if defined(CONFIG_NET_HOSTNAME_ENABLE)
#define DEVICE_NAME CONFIG_NET_HOSTNAME
#else
#define DEVICE_NAME CONFIG_ESPHOME_API_DEVICE_NAME
#endif

static int relay_calls;
static bool relay_last;
static int reset_calls;

static void relay_cb(struct esphome_entity *e, bool state)
{
	relay_calls++;
	relay_last = state;
	/* Confirm from inside the callback, as an app would. */
	zassert_ok(esphome_api_publish_bool(e, state));
}

static void reset_cb(struct esphome_entity *e)
{
	reset_calls++;
}

ESPHOME_SENSOR_DEFINE(temperature, .name = "Temperature", .unit = "°C",
		      .device_class = "temperature", .state_class = ESPHOME_STATE_CLASS_MEASUREMENT,
		      .accuracy_decimals = 1);
ESPHOME_BINARY_SENSOR_DEFINE(stopped, .name = "Stopped");
ESPHOME_SWITCH_DEFINE(relay, .on_switch = relay_cb);
ESPHOME_BUTTON_DEFINE(reset, .name = "Reset", .on_press = reset_cb);

/* Spans several chunks, the last one partial. */
static uint8_t image[2000];
static int release_calls;

static int get_image_cb(struct esphome_entity *e, const uint8_t **data, size_t *len)
{
	*data = image;
	*len = sizeof(image);
	return 0;
}

static void release_image_cb(struct esphome_entity *e)
{
	release_calls++;
}

ESPHOME_CAMERA_DEFINE(cam, .name = "Camera", .get_image = get_image_cb,
		      .release_image = release_image_cb);

static uint8_t buf[1024];
static int open_fd = -1;

static int connect_to(int family, const char *ip)
{
	struct net_sockaddr_storage ss = {0};
	struct net_sockaddr_in *in = (struct net_sockaddr_in *)&ss;
	struct net_sockaddr_in6 *in6 = (struct net_sockaddr_in6 *)&ss;
	struct zsock_timeval tv = {.tv_sec = 1};
	int fd = zsock_socket(family, NET_SOCK_STREAM, NET_IPPROTO_TCP);

	zassert_true(fd >= 0);
	open_fd = fd;
	if (family == NET_AF_INET) {
		in->sin_family = NET_AF_INET;
		in->sin_port = net_htons(CONFIG_ESPHOME_API_PORT);
		zassert_equal(zsock_inet_pton(NET_AF_INET, ip, &in->sin_addr), 1);
	} else {
		in6->sin6_family = NET_AF_INET6;
		in6->sin6_port = net_htons(CONFIG_ESPHOME_API_PORT);
		zassert_equal(zsock_inet_pton(NET_AF_INET6, ip, &in6->sin6_addr), 1);
	}
	zassert_ok(zsock_setsockopt(fd, ZSOCK_SOL_SOCKET, ZSOCK_SO_RCVTIMEO, &tv, sizeof(tv)));
	zassert_ok(zsock_connect(fd, (struct net_sockaddr *)&ss,
				 family == NET_AF_INET ? sizeof(*in) : sizeof(*in6)),
		   "connect %s: %d", ip, errno);

	return fd;
}

static int connect_server(void)
{
	return connect_to(NET_AF_INET, "127.0.0.1");
}

static void send_raw(int fd, const uint8_t *data, size_t len)
{
	zassert_equal(zsock_send(fd, data, len, 0), len);
}

static void send_frame(int fd, uint32_t type, const pb_msgdesc_t *fields, const void *msg)
{
	uint8_t frame[128];
	size_t len = 0;
	pb_ostream_t os;

	if (fields != NULL) {
		zassert_true(pb_get_encoded_size(&len, fields, msg));
	}
	size_t hdr = 2;

	/* Test messages are short enough for a single-byte length. */
	zassert_true(len < 128);
	frame[0] = 0x00;
	frame[1] = len;
	do {
		frame[hdr++] = (type & 0x7f) | (type > 0x7f ? 0x80 : 0);
		type >>= 7;
	} while (type != 0);
	if (fields != NULL) {
		os = pb_ostream_from_buffer(&frame[hdr], sizeof(frame) - hdr);
		zassert_true(pb_encode(&os, fields, msg));
	}
	send_raw(fd, frame, hdr + len);
}

static int recv_exact(int fd, uint8_t *dst, size_t len)
{
	while (len > 0) {
		ssize_t n = zsock_recv(fd, dst, len, 0);

		if (n <= 0) {
			return n == 0 ? -ECONNRESET : -errno;
		}
		dst += n;
		len -= n;
	}

	return 0;
}

static int recv_varint(int fd, uint32_t *val)
{
	uint8_t b;
	int ret;

	*val = 0;
	for (int shift = 0; shift < 35; shift += 7) {
		ret = recv_exact(fd, &b, 1);
		if (ret < 0) {
			return ret;
		}
		*val |= (uint32_t)(b & 0x7f) << shift;
		if ((b & 0x80) == 0) {
			return 0;
		}
	}

	return -EBADMSG;
}

/* Returns the body length into buf, or a negative errno (-ECONNRESET when closed). */
static int recv_frame(int fd, uint32_t *type)
{
	uint8_t preamble;
	uint32_t len;
	int ret;

	ret = recv_exact(fd, &preamble, 1);
	if (ret < 0) {
		return ret;
	}
	zassert_equal(preamble, 0x00);
	zassert_ok(recv_varint(fd, &len));
	zassert_ok(recv_varint(fd, type));
	zassert_true(len <= sizeof(buf));
	ret = recv_exact(fd, buf, len);

	return ret < 0 ? ret : (int)len;
}

static void expect_frame(int fd, uint32_t type, const pb_msgdesc_t *fields, void *msg)
{
	uint32_t got;
	int len = recv_frame(fd, &got);
	pb_istream_t is;

	zassert_true(len >= 0, "recv %d", len);
	zassert_equal(got, type, "expected %u, got %u", type, got);
	if (fields != NULL) {
		is = pb_istream_from_buffer(buf, len);
		zassert_true(pb_decode(&is, fields, msg));
	}
}

static void expect_closed(int fd)
{
	uint32_t type;

	zassert_equal(recv_frame(fd, &type), -ECONNRESET);
	zsock_close(fd);
	open_fd = -1;
}

static int connect_hello(void)
{
	int fd = connect_server();
	HelloRequest req = {.api_version_major = 1, .api_version_minor = 19};
	HelloResponse resp;

	strcpy(req.client_info, "ztest");
	send_frame(fd, HelloRequest_msgid, HelloRequest_fields, &req);
	expect_frame(fd, HelloResponse_msgid, HelloResponse_fields, &resp);
	zassert_equal(resp.api_version_major, ESPHOME_API_VERSION_MAJOR);
	zassert_equal(resp.api_version_minor, ESPHOME_API_VERSION_MINOR);
	zassert_str_equal(resp.name, DEVICE_NAME);

	return fd;
}

static void disconnect(int fd)
{
	send_frame(fd, DisconnectRequest_msgid, NULL, NULL);
	expect_frame(fd, DisconnectResponse_msgid, NULL, NULL);
	expect_closed(fd);
}

ZTEST(esphome_api_server, test_hello_ping_disconnect)
{
	int fd = connect_hello();

	send_frame(fd, PingRequest_msgid, NULL, NULL);
	expect_frame(fd, PingResponse_msgid, NULL, NULL);
	disconnect(fd);
}

#if defined(CONFIG_NET_IPV6)
/* The IPv4 tests above reach the same listener through v4-mapped addresses. */
ZTEST(esphome_api_server, test_ipv6_ping)
{
	int fd = connect_to(NET_AF_INET6, "::1");

	send_frame(fd, PingRequest_msgid, NULL, NULL);
	expect_frame(fd, PingResponse_msgid, NULL, NULL);
	disconnect(fd);
}
#endif

ZTEST(esphome_api_server, test_request_before_hello_closes)
{
	int fd = connect_server();

	send_frame(fd, DeviceInfoRequest_msgid, NULL, NULL);
	expect_closed(fd);
}

ZTEST(esphome_api_server, test_noise_preamble_closes)
{
	static const uint8_t noise_hello[] = {0x01, 0x00, 0x00};
	int fd = connect_server();

	send_raw(fd, noise_hello, sizeof(noise_hello));
	expect_closed(fd);
}

ZTEST(esphome_api_server, test_oversized_frame_closes)
{
	/* length 0x4000 > CONFIG_ESPHOME_API_RX_BUF_SIZE */
	static const uint8_t frame[] = {0x00, 0x80, 0x80, 0x01, 0x01};
	int fd = connect_hello();

	send_raw(fd, frame, sizeof(frame));
	expect_closed(fd);
}

ZTEST(esphome_api_server, test_device_info_and_capabilities)
{
	int fd = connect_hello();
	DeviceInfoResponse info;

	send_frame(fd, DeviceInfoRequest_msgid, NULL, NULL);
	expect_frame(fd, DeviceInfoResponse_msgid, DeviceInfoResponse_fields, &info);
	zassert_str_equal(info.name, DEVICE_NAME);
	zassert_str_equal(info.model, CONFIG_BOARD);
	zassert_equal(strlen(info.mac_address), 17);
	zassert_false(info.api_encryption_supported);

	send_frame(fd, DeviceCapabilitiesRequest_msgid, NULL, NULL);
	expect_frame(fd, DeviceCapabilitiesResponse_msgid, NULL, NULL);
	disconnect(fd);
}

ZTEST(esphome_api_server, test_unknown_message_ignored)
{
	int fd = connect_hello();

	/* SubscribeLogsRequest (28) with level 3: Home Assistant sends it, we have no logs. */
	static const uint8_t logs[] = {0x00, 0x02, 28, 0x08, 0x03};

	send_raw(fd, logs, sizeof(logs));
	send_frame(fd, PingRequest_msgid, NULL, NULL);
	expect_frame(fd, PingResponse_msgid, NULL, NULL);
	disconnect(fd);
}

ZTEST(esphome_api_server, test_list_entities)
{
	int fd = connect_hello();
	uint32_t seen = 0;
	uint32_t type;
	int len;

	send_frame(fd, ListEntitiesRequest_msgid, NULL, NULL);
	while ((len = recv_frame(fd, &type)) >= 0 && type != ListEntitiesDoneResponse_msgid) {
		pb_istream_t is = pb_istream_from_buffer(buf, len);

		switch (type) {
		case ListEntitiesSensorResponse_msgid: {
			ListEntitiesSensorResponse m;

			zassert_true(pb_decode(&is, ListEntitiesSensorResponse_fields, &m));
			zassert_equal(m.key, KEY_TEMPERATURE);
			zassert_str_equal(m.object_id, "temperature");
			zassert_str_equal(m.name, "Temperature");
			zassert_str_equal(m.unit_of_measurement, "°C");
			zassert_str_equal(m.device_class, "temperature");
			zassert_equal(m.state_class, SensorStateClass_STATE_CLASS_MEASUREMENT);
			zassert_equal(m.accuracy_decimals, 1);
			seen |= BIT(0);
			break;
		}
		case ListEntitiesBinarySensorResponse_msgid: {
			ListEntitiesBinarySensorResponse m;

			zassert_true(pb_decode(&is, ListEntitiesBinarySensorResponse_fields, &m));
			zassert_equal(m.key, KEY_STOPPED);
			seen |= BIT(1);
			break;
		}
		case ListEntitiesSwitchResponse_msgid: {
			ListEntitiesSwitchResponse m;

			zassert_true(pb_decode(&is, ListEntitiesSwitchResponse_fields, &m));
			zassert_equal(m.key, KEY_RELAY);
			/* No .name: falls back to the object_id. */
			zassert_str_equal(m.name, "relay");
			seen |= BIT(2);
			break;
		}
		case ListEntitiesButtonResponse_msgid: {
			ListEntitiesButtonResponse m;

			zassert_true(pb_decode(&is, ListEntitiesButtonResponse_fields, &m));
			zassert_equal(m.key, KEY_RESET);
			seen |= BIT(3);
			break;
		}
		case ListEntitiesCameraResponse_msgid: {
			ListEntitiesCameraResponse m;

			zassert_true(pb_decode(&is, ListEntitiesCameraResponse_fields, &m));
			zassert_equal(m.key, KEY_CAM);
			zassert_str_equal(m.name, "Camera");
			seen |= BIT(4);
			break;
		}
		default:
			zassert_unreachable("unexpected message %u", type);
		}
	}
	zassert_true(len >= 0);
	zassert_equal(seen, BIT_MASK(5));
	disconnect(fd);
}

ZTEST(esphome_api_server, test_states_and_commands)
{
	int fd = connect_hello();
	SensorStateResponse sensor;
	BinarySensorStateResponse binary;
	SwitchStateResponse sw;
	SwitchCommandRequest cmd = {.key = KEY_RELAY, .state = true};
	ButtonCommandRequest press = {.key = KEY_RESET};

	zassert_ok(esphome_api_publish_float(&temperature, 21.5f));
	zassert_equal(esphome_api_publish_float(&stopped, 1.0f), -EINVAL);
	zassert_equal(esphome_api_publish_bool(&reset, true), -EINVAL);

	/* Initial states in section order (relay, stopped, temperature); buttons have none. */
	send_frame(fd, SubscribeStatesRequest_msgid, NULL, NULL);
	expect_frame(fd, SwitchStateResponse_msgid, SwitchStateResponse_fields, &sw);
	zassert_equal(sw.key, KEY_RELAY);
	zassert_true(sw.missing_state);
	expect_frame(fd, BinarySensorStateResponse_msgid, BinarySensorStateResponse_fields,
		     &binary);
	zassert_equal(binary.key, KEY_STOPPED);
	zassert_true(binary.missing_state);
	expect_frame(fd, SensorStateResponse_msgid, SensorStateResponse_fields, &sensor);
	zassert_equal(sensor.key, KEY_TEMPERATURE);
	zassert_false(sensor.missing_state);
	zassert_equal(sensor.state, 21.5f);

	/* Updates after subscribing are pushed. */
	zassert_ok(esphome_api_publish_bool(&stopped, true));
	expect_frame(fd, BinarySensorStateResponse_msgid, BinarySensorStateResponse_fields,
		     &binary);
	zassert_true(binary.state);
	zassert_false(binary.missing_state);

	/* Switch command reaches the callback, which confirms the state. */
	send_frame(fd, SwitchCommandRequest_msgid, SwitchCommandRequest_fields, &cmd);
	expect_frame(fd, SwitchStateResponse_msgid, SwitchStateResponse_fields, &sw);
	zassert_equal(relay_calls, 1);
	zassert_true(relay_last);
	zassert_true(sw.state);

	send_frame(fd, ButtonCommandRequest_msgid, ButtonCommandRequest_fields, &press);
	/* A key that matches nothing is ignored. */
	press.key = KEY_RELAY;
	send_frame(fd, ButtonCommandRequest_msgid, ButtonCommandRequest_fields, &press);
	send_frame(fd, PingRequest_msgid, NULL, NULL);
	expect_frame(fd, PingResponse_msgid, NULL, NULL);
	zassert_equal(reset_calls, 1);
	disconnect(fd);
}

struct image_rx {
	uint8_t data[sizeof(image)];
	size_t len;
};

static bool decode_chunk(pb_istream_t *is, const pb_field_t *field, void **arg)
{
	struct image_rx *rx = *arg;
	size_t n = is->bytes_left;

	if (rx->len + n > sizeof(rx->data)) {
		return false;
	}
	if (!pb_read(is, &rx->data[rx->len], n)) {
		return false;
	}
	rx->len += n;
	return true;
}

ZTEST(esphome_api_server, test_camera_image)
{
	static struct image_rx rx;
	int fd = connect_hello();
	CameraImageRequest req = {.single = true};
	CameraImageResponse m;
	int frames = 0;

	for (size_t i = 0; i < sizeof(image); i++) {
		image[i] = (uint8_t)(i * 7U);
	}
	rx.len = 0U;
	release_calls = 0;

	send_frame(fd, CameraImageRequest_msgid, CameraImageRequest_fields, &req);
	do {
		m = (CameraImageResponse){.data = {.funcs.decode = decode_chunk, .arg = &rx}};
		expect_frame(fd, CameraImageResponse_msgid, CameraImageResponse_fields, &m);
		zassert_equal(m.key, KEY_CAM);
		frames++;
	} while (!m.done);

	zassert_true(frames > 1, "one frame for %zu bytes", sizeof(image));
	zassert_equal(rx.len, sizeof(image));
	zassert_mem_equal(rx.data, image, sizeof(image));
	zassert_equal(release_calls, 1);
	disconnect(fd);
}

ZTEST(esphome_api_server, test_unsubscribed_client_gets_no_states)
{
	int fd = connect_hello();
	uint32_t type;

	zassert_ok(esphome_api_publish_float(&temperature, 1.0f));
	send_frame(fd, PingRequest_msgid, NULL, NULL);
	zassert_true(recv_frame(fd, &type) >= 0);
	zassert_equal(type, PingResponse_msgid);
	disconnect(fd);
}

ZTEST(esphome_api_server, test_idle_client_closed)
{
	int fd = connect_hello();
	struct zsock_timeval tv = {.tv_sec = CONFIG_ESPHOME_API_IDLE_TIMEOUT + 2};

	zassert_ok(zsock_setsockopt(fd, ZSOCK_SOL_SOCKET, ZSOCK_SO_RCVTIMEO, &tv, sizeof(tv)));
	expect_closed(fd);
}

static void *setup(void)
{
	/* Let the server thread open its listener. */
	k_sleep(K_MSEC(100));
	return NULL;
}

/* A failed assertion leaves its socket open; close it so later tests get a slot. */
static void after(void *fixture)
{
	if (open_fd >= 0) {
		zsock_close(open_fd);
		open_fd = -1;
		k_sleep(K_MSEC(50));
	}
}

ZTEST_SUITE(esphome_api_server, NULL, setup, NULL, after, NULL);
```
