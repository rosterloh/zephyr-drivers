## tests/subsys/net/esphome_api/testcase.yaml
```yaml
common:
  tags: [esphome_api]
  modules: [nanopb]
tests:
  net.esphome_api.proto:
    platform_allow:
      - native_sim
      - qemu_cortex_m3
      - esp32c3_devkitc/esp32c3/qemu
    integration_platforms: [native_sim]
  net.esphome_api.mdns:
    extra_args: EXTRA_CONF_FILE=mdns.conf
    platform_allow:
      - native_sim
      - qemu_cortex_m3
      - esp32c3_devkitc/esp32c3/qemu
    integration_platforms: [native_sim]
  net.esphome_api.noise:
    extra_args: EXTRA_CONF_FILE=noise.conf
    modules: [nanopb, mbedtls, tf-psa-crypto]
    platform_allow:
      - native_sim
      - qemu_cortex_m3
      - esp32c3_devkitc/esp32c3/qemu
    integration_platforms: [native_sim]
  net.esphome_api.ipv6:
    extra_args: EXTRA_CONF_FILE=ipv6.conf
    platform_allow:
      - native_sim
      - qemu_cortex_m3
      - esp32c3_devkitc/esp32c3/qemu
    integration_platforms: [native_sim]
```

## tests/subsys/opendisplay/direct/testcase.yaml
```yaml
common:
  tags: [opendisplay]
  platform_allow:
    - native_sim
    - qemu_cortex_m3
  integration_platforms: [native_sim]
tests:
  opendisplay.direct: {}
```

## tests/subsys/opendisplay/security/testcase.yaml
```yaml
common:
  tags: [opendisplay]
  platform_allow:
    - native_sim
    - qemu_cortex_m3
  integration_platforms: [native_sim]
tests:
  opendisplay.security: {}
  opendisplay.security.ble:
    build_only: true
    extra_args: EXTRA_CONF_FILE=../core/ble.conf
```
