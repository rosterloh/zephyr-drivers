## dts/bindings/sensor/adafruit,seesaw-encoder.yaml
```yaml
description: |
  Rotary encoder child of an adafruit,seesaw-mfd MFD. Reports the encoder
  position as SENSOR_CHAN_ROTATION (signed step count from
  SEESAW_ENCODER_POSITION).

compatible: "adafruit,seesaw-encoder"

include: [sensor-device.yaml, base.yaml]
```

## dts/bindings/sensor/ams,as7341.yaml
```yaml
description: |
    AMS AS7341 11-Channel Multi-Spectral sensor.
    See more info at https://ams.com/en/as7341

compatible: "ams,as7341"

include: [sensor-device.yaml, i2c-device.yaml]
```

## dts/bindings/sensor/pps,singletact.yaml
```yaml
description: |
    SingleTact force sensor.
    See more info at http://www.singletact.com/

compatible: "pps,singletact"

include: [sensor-device.yaml, i2c-device.yaml]

properties:
  baseline-samples:
    type: int
    required: false
    default: 3
    description: How many samples to take at startup to get a baseline.

  sensor-rating:
    type: int
    required: false
    default: 4500
    description: The force rating of the sensor attached in mN.
    enum:
      - 4500
      - 45000
      - 450000
```
