## drivers/gpio/Kconfig.adafruit_seesaw
```kconfig
config GPIO_ADAFRUIT_SEESAW
	bool "Adafruit Seesaw GPIO"
	default y
	depends on DT_HAS_ADAFRUIT_SEESAW_GPIO_ENABLED
	depends on MFD_ADAFRUIT_SEESAW
	help
	  Adafruit Seesaw GPIO child driver.

if GPIO_ADAFRUIT_SEESAW
module = GPIO_ADAFRUIT_SEESAW
module-str = gpio_adafruit_seesaw
source "subsys/logging/Kconfig.template.log_config"

config GPIO_ADAFRUIT_SEESAW_INIT_PRIORITY
	int "Init priority"
	default 85
	help
	  Must be greater than MFD_ADAFRUIT_SEESAW_INIT_PRIORITY.
endif
```

## drivers/led_strip/Kconfig.adafruit_seesaw
```kconfig
config LED_STRIP_ADAFRUIT_SEESAW
	bool "Adafruit Seesaw NeoPixel"
	default y
	depends on DT_HAS_ADAFRUIT_SEESAW_NEOPIXEL_ENABLED
	depends on MFD_ADAFRUIT_SEESAW
	depends on LED_STRIP
	help
	  Adafruit Seesaw NeoPixel LED strip driver. Drives a chain of WS2812-
	  family LEDs via the seesaw's NEOPIXEL module.

if LED_STRIP_ADAFRUIT_SEESAW
module = LED_STRIP_ADAFRUIT_SEESAW
module-str = led_strip_adafruit_seesaw
source "subsys/logging/Kconfig.template.log_config"

config LED_STRIP_ADAFRUIT_SEESAW_INIT_PRIORITY
	int "Init priority"
	default 85
	help
	  Must be greater than MFD_ADAFRUIT_SEESAW_INIT_PRIORITY (80).
endif
```

## drivers/mfd/seesaw/Kconfig
```kconfig
config MFD_ADAFRUIT_SEESAW
	bool "Adafruit Seesaw MFD"
	default y
	depends on DT_HAS_ADAFRUIT_SEESAW_MFD_ENABLED
	select I2C
	help
	  Adafruit Seesaw MFD parent driver. Exposes register transport and
	  INT fan-out to subsystem children (gpio/adc/pwm/led_strip/encoder).

if MFD_ADAFRUIT_SEESAW

module = MFD_ADAFRUIT_SEESAW
module-str = mfd_adafruit_seesaw
source "subsys/logging/Kconfig.template.log_config"

config MFD_ADAFRUIT_SEESAW_INIT_PRIORITY
	int "Init priority"
	default 80
	help
	  Must be higher (= run later) than I2C bus controller init priority
	  and lower (= run earlier) than every child's init priority.

config MFD_ADAFRUIT_SEESAW_INT
	bool "Enable INT-line fan-out"
	default y if $(dt_compat_any_has_prop,$(DT_COMPAT_ADAFRUIT_SEESAW_MFD),int-gpios)
	depends on GPIO
	help
	  Build INT-line trigger code. Required by children that use seesaw
	  interrupts (gpio edge events, encoder events).

config MFD_ADAFRUIT_SEESAW_INT_THREAD_STACK_SIZE
	int "INT-line worker thread stack size"
	depends on MFD_ADAFRUIT_SEESAW_INT
	default 1024

endif # MFD_ADAFRUIT_SEESAW
```

## drivers/pwm/Kconfig.adafruit_seesaw
```kconfig
config PWM_ADAFRUIT_SEESAW
	bool "Adafruit Seesaw PWM"
	default y
	depends on DT_HAS_ADAFRUIT_SEESAW_PWM_ENABLED
	depends on MFD_ADAFRUIT_SEESAW
	depends on PWM
	help
	  Adafruit Seesaw PWM child driver.

if PWM_ADAFRUIT_SEESAW
module = PWM_ADAFRUIT_SEESAW
module-str = pwm_adafruit_seesaw
source "subsys/logging/Kconfig.template.log_config"

config PWM_ADAFRUIT_SEESAW_INIT_PRIORITY
	int "Init priority"
	default 85
	help
	  Must be greater than MFD_ADAFRUIT_SEESAW_INIT_PRIORITY (80).
endif
```

## drivers/seesaw/Kconfig
```kconfig
# Kconfig - Adafruit SeeSaw sensor driver

menuconfig SEESAW
	bool "SeeSaw driver"
	default y
	depends on DT_HAS_ADAFRUIT_SEESAW_ENABLED
	select I2C
	help
	  Enable SeeSaw driver.

if SEESAW

module = SEESAW
module-str = seesaw
source "subsys/logging/Kconfig.template.log_config"

config SEESAW_INIT_PRIORITY
	int "SeeSaw init priority"
	default 90
	help
	  System initialisation priority for SeeSaw drivers.

choice
	prompt "Trigger mode"
	default SEESAW_TRIGGER_NONE
	help
	  Specify the type of triggering used by the driver.

config SEESAW_TRIGGER_NONE
	bool "No trigger"

config SEESAW_TRIGGER_GLOBAL_THREAD
	bool "Use global thread"
	depends on GPIO
	select SEESAW_TRIGGER

config SEESAW_TRIGGER_OWN_THREAD
	bool "Use own thread"
	depends on GPIO
	select SEESAW_TRIGGER

endchoice

config SEESAW_TRIGGER
	bool

config SEESAW_THREAD_PRIORITY
	int "Thread priority"
	depends on SEESAW_TRIGGER_OWN_THREAD && SEESAW_TRIGGER
	default 10
	help
	  Priority of thread used by the driver to handle interrupts.

config SEESAW_THREAD_STACK_SIZE
	int "Thread stack size"
	depends on SEESAW_TRIGGER_OWN_THREAD && SEESAW_TRIGGER
	default 1024
	help
	  Stack size of thread used by the driver to handle interrupts.

endif #SEESAW
```

## drivers/sensor/Kconfig
```kconfig
if SENSOR
rsource "as7341/Kconfig"
rsource "singletact/Kconfig"
rsource "adafruit_seesaw_encoder/Kconfig"
rsource "esp32_pcnt_encoder/Kconfig"
endif # SENSOR
```

## drivers/sensor/adafruit_seesaw_encoder/Kconfig
```kconfig
config ADAFRUIT_SEESAW_ENCODER
	bool "Adafruit Seesaw rotary encoder"
	default y
	depends on DT_HAS_ADAFRUIT_SEESAW_ENCODER_ENABLED
	depends on MFD_ADAFRUIT_SEESAW
	help
	  Rotary encoder support for Adafruit's I2C rotary encoder breakout
	  (PID 4991 / 5740) and similar seesaw-firmware encoders. Exposes
	  position as SENSOR_CHAN_ROTATION.

if ADAFRUIT_SEESAW_ENCODER
module = ADAFRUIT_SEESAW_ENCODER
module-str = adafruit_seesaw_encoder
source "subsys/logging/Kconfig.template.log_config"
endif
```

## drivers/sensor/as7341/Kconfig
```kconfig
# AS7341 Multi-Spectral sensor configuration option

menuconfig AS7341
	bool "OSRAM-AMS AS7341 Multi-Spectral sensor"
	default y
	depends on DT_HAS_AMS_AS7341_ENABLED
	select I2C
	help
	  Enable driver for AS7341 sensor.

if AS7341

config AS7341_FETCH_WAIT
	bool "Wait for valid sensor reading before fetch"
	help
	  If set, the driver will automatically wait for the duration of an integration cycle
	  during a fetch call if necessary.

config AS7341_WARN_SATURATED
	bool "Warn if sensor is potentially saturated"
	help
	  If set, the driver will warn if the sensor ADC is
	  potentially saturated after a data fetch.

endif # AS7341
```

## drivers/sensor/esp32_pcnt_encoder/Kconfig
```kconfig
config ESP32_PCNT_ENCODER
	bool "ESP32 PCNT multi-unit encoder"
	default y
	depends on DT_HAS_ROSTERLOH_ESP32_PCNT_ENABLED
	depends on PINCTRL
	help
	  Encoder driver for the ESP32 pulse counter (PCNT) block. Each unit
	  child node becomes its own sensor device reporting accumulated
	  position on SENSOR_CHAN_ROTATION (degrees), with 16-bit hardware
	  overflow folded into a 64-bit software accumulator via limit-event
	  interrupts.

if ESP32_PCNT_ENCODER
module = ESP32_PCNT_ENCODER
module-str = esp32_pcnt_encoder
source "subsys/logging/Kconfig.template.log_config"
endif
```

## drivers/sensor/singletact/Kconfig
```kconfig
# SingleTact force sensor configuration option

config SINGLETACT
	bool "SingleTact force sensor"
	default y
	depends on DT_HAS_PPS_SINGLETACT_ENABLED
	select I2C
	help
	  Enable driver for SingleTact sensor.
```

## dts/bindings/actuator/actuator-common.yaml
```yaml
# Common properties for any rosterloh actuator backend.
# Included by per-backend YAMLs.

properties:
  default-mode:
    type: string
    enum:
      - "position"
      - "velocity"
      - "effort"
    default: "position"
    description: |
      Mode the subsystem promotes the actuator to on first setpoint call.

  update-period-ms:
    type: int
    default: 100
    description: |
      Period of the driver's internal feedback worker. Each tick the driver
      reads fresh state from the hardware and fires registered feedback callbacks.

  label:
    type: string
    description: Human-readable label.
```

## dts/bindings/actuator/rosterloh,actuator-dxl.yaml
```yaml
description: |
  Smart-servo actuator backed by the rosterloh dynamixel driver. Each instance
  is a child of a robotis,dynamixel bus node; the driver discovers the parent
  iface via DT_BUS at compile time.

compatible: "rosterloh,actuator-dxl"

include: [actuator-common.yaml]

properties:
  reg:
    type: int
    required: true
    description: Dynamixel bus ID (1..253).

  torque-constant-mnm-per-a:
    type: int
    description: |
      Per-model torque constant in milli-N*m per Ampere. Required if effort
      mode is enabled. e.g. XL330-M288 ~= 320.

  position-min-rad-milli:
    type: int
  position-max-rad-milli:
    type: int

  gear-ratio-num:
    type: int
    default: 1
  gear-ratio-den:
    type: int
    default: 1

  profile-velocity:
    type: int
    description: |
      Optional Dynamixel PROFILE_VELOCITY register applied at init.

  ticks-per-rev:
    type: int
    default: 4096
    description: |
      Encoder counts per revolution. Standard X-series = 4096.

  rad-zero-tick:
    type: int
    default: 2048
    description: |
      Tick value corresponding to 0 rad. Standard X-series = 2048
      (centered range: 0..4095 ticks <-> -pi..+pi rad).
```

## dts/bindings/adafruit,seesaw.yaml
```yaml
description: |
  Adafruit SeeSaw driver. See more info at:
  https://learn.adafruit.com/adafruit-seesaw-atsamd09-breakout/overview

compatible: "adafruit,seesaw"

include: i2c-device.yaml

properties:
  int-gpios:
    type: phandle-array
    description: Interrupt gpio pin

  read-delay-ms:
    type: int
    default: 250
    description: |
      Default delay time in ms after writing before a read
      If not specified defaults to 250.

  capabilities:
    type: string
    default: "neokey"
    enum:
      - "neokey"
    description: Predefined boards which are based on SeeSaw controllers.
```

## dts/bindings/gpio/adafruit,seesaw-gpio.yaml
```yaml
description: |
  GPIO child of an adafruit,seesaw-mfd MFD. Exposes the seesaw chip's GPIO
  module (SEESAW_GPIO_BASE) as a standard Zephyr GPIO controller.

compatible: "adafruit,seesaw-gpio"

include: [gpio-controller.yaml, base.yaml]

properties:
  ngpios:
    type: int
    default: 32
    description: |
      Number of GPIO pins. The seesaw GPIO module accepts a 32-bit bulk mask;
      the actual chip exposes fewer (e.g. SAMD09: pins 0–24 minus reserved).
      Apps should respect the chip-specific subset.

  "#gpio-cells":
    const: 2

gpio-cells:
  - pin
  - flags
```

## dts/bindings/gpio/adafruit-qtpy-header.yaml
```yaml
description: |
    GPIO pins exposed on Adafruit QT Py headers.

    The Adafruit QT Py layout provides two headers, along opposite
    edges of the board.

    Proceeding counter-clockwise:
    * A 7-pin Digital/Analog Input header.  This has input signals
      labeled from 0 at the top through 6 at the bottom.
    * An 7-pin header Power and Digital/Analog Input header.  This
      has three power pins, followed by four inputs labeled 10 at the
      top through 7 at the bottom.

    This binding provides a nexus mapping for 10 pins where parent pins 0
    through 10 correspond to D0 through D10, as depicted below:

        0 A0                     5V  -
        1 A1                     GND -
        2 A2                     3V  -
        3 A3                     MO  10
        4 SDA                    MI  9
        5 SCL                    SCK 8
        6 Tx                     Rx  7


compatible: "adafruit,qtpy-gpio"

include: [gpio-nexus.yaml, base.yaml]
```

## dts/bindings/kinematics/rosterloh,joint.yaml
```yaml
# Copyright (c) 2026 Richard Osterloh
# SPDX-License-Identifier: Apache-2.0

description: |
  A single mechanical joint exposed by this device (URDF-style). The kinematics
  library collects all enabled joint nodes into a descriptor table and can
  serialize them to CBOR for a remote controller to assemble a kinematic tree.

  Devicetree has no float type, so fractional values are scaled integers; the
  library converts them to SI floats. Units are noted per property.

compatible: "rosterloh,joint"

properties:
  link-parent:
    type: string
    required: true
    description: Parent link name (URDF parent).
  link-child:
    type: string
    required: true
    description: Child link name (URDF child).
  joint-type:
    type: string
    required: true
    enum: ["fixed", "revolute", "continuous", "prismatic"]
    description: URDF joint type.
  axis:
    type: array
    required: true
    description: Joint axis as a unit vector scaled x1000, e.g. <0 0 1000> for +Z.
  origin-xyz:
    type: array
    required: true
    description: Origin translation from parent, micrometres [x y z].
  origin-rpy:
    type: array
    required: true
    description: Origin rotation from parent, microradians [r p y].
  limit-lower:
    type: int
    description: Lower position limit, microradians (revolute) or micrometres (prismatic).
  limit-upper:
    type: int
    description: Upper position limit, microradians or micrometres.
  limit-velocity:
    type: int
    description: Velocity limit, microradians/s or micrometres/s.
  limit-effort:
    type: int
    description: Effort limit, milli-N*m (revolute) or milli-N (prismatic).
  mass-mg:
    type: int
    description: Link mass in milligrams. Presence enables the dynamics block.
  com-xyz:
    type: array
    description: Centre-of-mass offset, micrometres [x y z].
  inertia:
    type: array
    description: Inertia tensor [ixx iyy izz ixy ixz iyz] in g*mm^2.
  actuator:
    type: phandle
    description: Optional actuator device that drives this joint.
```

## dts/bindings/led_strip/adafruit,seesaw-neopixel.yaml
```yaml
description: |
  NeoPixel chain driven through an adafruit,seesaw-mfd MFD. Wraps the
  SEESAW_NEOPIXEL_BASE module: pin assignment, speed select, buffer
  length, framebuffer writes, and SHOW trigger.

compatible: "adafruit,seesaw-neopixel"

include: led-strip.yaml

properties:
  seesaw-pin:
    type: int
    required: true
    description: Seesaw GPIO pin index that the NeoPixel data line is wired to.

  frequency:
    type: int
    default: 800000
    enum:
      - 400000
      - 800000
    description: NeoPixel data rate (Hz). 400 kHz or 800 kHz.

  pixel-buffer-size:
    type: int
    default: 64
    description: |
      Bytes reserved for the in-memory framebuffer. Must be at least
      chain-length * 3. RGBW strips are not supported in this version
      (LED_COLOR_ID_WHITE entries in color-mapping are written as zero).
```

## dts/bindings/mfd/adafruit,seesaw-mfd.yaml
```yaml
description: |
  Adafruit Seesaw MFD parent. The chip is a SAMD09 or ATtiny8xx/16xx running
  Adafruit's Seesaw firmware. Child nodes (gpio, adc, pwm, led_strip, encoder)
  attach below this node and reference its register-transport API.

compatible: "adafruit,seesaw-mfd"

include: i2c-device.yaml

properties:
  int-gpios:
    type: phandle-array
    description: |
      Host GPIO connected to the seesaw INT pin. Optional. If provided, the
      MFD parent will fan interrupts out to children that opt in via
      mfd_seesaw_add_int_callback().

  read-delay-us:
    type: int
    default: 250
    description: |
      Microseconds to busy-wait between a register-address write and the
      following read. Some firmware revisions need this; default 250 us.

child-binding:
  description: |
    Generic child binding placeholder. Concrete child bindings are defined
    per-subsystem (adafruit,seesaw-gpio, etc.).
```

## dts/bindings/pwm/adafruit,seesaw-pwm.yaml
```yaml
description: |
  PWM child of an adafruit,seesaw-mfd MFD. Wraps SEESAW_TIMER_BASE:
  per-pin 16-bit duty (TIMER_PWM) and per-pin Hz (TIMER_FREQ). Channels
  in pwm-cells map directly to chip GPIO pin numbers used as PWM outputs.

compatible: "adafruit,seesaw-pwm"

include: [pwm-controller.yaml, base.yaml]

properties:
  "#pwm-cells":
    const: 3

pwm-cells:
  - channel
  - period
  - flags
```

## dts/bindings/robotis,dynamixel.yaml
```yaml
description: Dynamixel over serial line device

compatible: "robotis,dynamixel"

include: uart-device.yaml

properties:
    tx-en-gpios:
      type: phandle-array
      required: false
      description: Transmit enable pin (TX_EN) of the transceiver.

child-binding:
    description: |
      Dynamixel motor on this bus. Children should declare
      compatible = "rosterloh,actuator-dxl"; the bare-child schema below
      remains for backward compatibility but is deprecated.
    properties:
      label:
        type: string
        required: false

      id:
        type: int
        required: false
        description: |
          Deprecated; use reg= on rosterloh,actuator-dxl children instead.
```
