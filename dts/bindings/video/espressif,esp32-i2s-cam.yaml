## tests/subsys/actuator/testcase.yaml
```yaml
common:
  tags: [actuator, subsys]
tests:
  subsys.actuator.basic:
    platform_allow: [native_sim]
  subsys.actuator.userspace:
    platform_allow: [mps2/an385]
    integration_platforms: [mps2/an385]
    # test_user_bad_pointer_is_refused oopses on purpose.
    ignore_faults: true
    extra_configs:
      - CONFIG_TEST_USERSPACE=y
      - CONFIG_FPU_SHARING=y
      - CONFIG_ZTEST_FATAL_HOOK=y
    extra_args: EXTRA_DTC_OVERLAY_FILE=boards/native_sim.overlay
```
