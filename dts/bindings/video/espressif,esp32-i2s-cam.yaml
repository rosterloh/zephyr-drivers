## dts/bindings/video/espressif,esp32-i2s-cam.yaml
```yaml
# Copyright (c) 2026 Richard Osterloh <richard.osterloh@gmail.com>
# SPDX-License-Identifier: Apache-2.0

description: |
  ESP32 I2S0 in camera mode: an 8-bit parallel (DVP) camera interface.

  The original ESP32 has no LCD_CAM block, so a DVP sensor is captured through
  I2S0's camera mode. Only JPEG output is supported, which is what an OV2640
  produces natively. The sensor master clock is generated on a PWM (LEDC)
  channel named "xclk".

    camera {
      compatible = "espressif,esp32-i2s-cam";
      i2s = <&i2s0>;
      pinctrl-0 = <&i2s0_cam_default>;
      pinctrl-names = "default";
      vsync-gpios = <&gpio0 25 GPIO_ACTIVE_HIGH>;
      pwms = <&ledc0 0 PWM_NSEC(50) PWM_POLARITY_NORMAL>;
      pwm-names = "xclk";
      source = <&ov2640>;
    };

  The pinctrl state must route D0..D7 to I2S0I_DATA_IN0..7, VSYNC to
  I2S0I_V_SYNC, HREF to I2S0I_H_SYNC and PCLK to I2S0I_WS_IN. Leave the
  i2s0 node disabled: this driver owns the peripheral.

compatible: "espressif,esp32-i2s-cam"

include: [base.yaml, pinctrl-device.yaml]

properties:
  i2s:
    type: phandle
    required: true
    description: The I2S0 node. Only I2S0 supports camera mode.

  source:
    type: phandle
    required: true
    description: Connected source device, i.e. the camera sensor.

  vsync-gpios:
    type: phandle-array
    required: true
    description: |
      The VSYNC pin, also routed to I2S0I_V_SYNC by pinctrl. Its edge
      interrupt marks frame boundaries.

  pwms:
    type: phandle-array
    required: true
    description: PWM channel that generates the sensor XCLK.

  pwm-names:
    type: string-array
    required: true
    description: Must be "xclk".

  pinctrl-0:
    required: true
```

## dts/bindings/video/ovti,ov3660.yaml
```yaml
# Copyright (c) 2026 Richard Osterloh <richard.osterloh@gmail.com>
# SPDX-License-Identifier: Apache-2.0

description: OmniVision OV3660 3 MP CMOS image sensor (DVP)

compatible: "ovti,ov3660"

include: i2c-device.yaml

properties:
  reset-gpios:
    type: phandle-array
    description: RESETB pin, active low on the sensor.

  pwdn-gpios:
    type: phandle-array
    description: PWDN pin, active high on the sensor.

child-binding:
  child-binding:
    include: video-interfaces.yaml
```

## dts/bindings/video/ovti,ov5647.yaml
```yaml
# Copyright (c) 2026 Richard Osterloh
# SPDX-License-Identifier: Apache-2.0

description: |
  OmniVision OV5647 5 Mega-Pixel MIPI CSI-2 image sensor, as fitted to the
  Raspberry Pi Camera Module v1.

  The module is self-clocked from an on-board 24 MHz oscillator, so "clocks"
  describes that fixed clock rather than one the host drives. The driver's
  register tables are derived for 24 MHz and it refuses any other rate.

compatible: "ovti,ov5647"

include: i2c-device.yaml

properties:
  clocks:
    required: true
    description: |
      The sensor's input clock (XVCLK). Must be 24 MHz.

child-binding:
  child-binding:
    include: video-interfaces.yaml
```

## lib/Kconfig
```kconfig
menu "Additional libraries"

rsource "actuator/Kconfig"
rsource "cdr/Kconfig"
rsource "kinematics/Kconfig"
rsource "uzlib/Kconfig"

endmenu
```

## lib/uzlib/Kconfig
```kconfig
# SPDX-License-Identifier: Apache-2.0

config UZLIB
	bool "uzlib inflate"
	help
	  Vendored uzlib v2.9.5 (Zlib license) deflate/zlib decompressor,
	  inflate side only. See lib/uzlib/README.
```

## samples/drivers/dynamixel/group_io/sample.yaml
```yaml
sample:
  name: Dynamixel group I/O
  description: |
    Demonstrates the SYNC_READ, SYNC_WRITE, BULK_READ and BULK_WRITE group
    instructions across multiple servos in single transactions.

tests:
  sample.drivers.dynamixel.group_io:
    tags:
      - drivers
      - dynamixel
      - samples
    platform_allow:
      - arduino_mkrzero
    integration_platforms:
      - arduino_mkrzero
    filter: dt_compat_enabled("robotis,dynamixel")
    harness: keyboard
```

## subsys/Kconfig
```kconfig
rsource "actuator/Kconfig"
rsource "net/wifi_connectivity/Kconfig"
rsource "net/lib/esphome_api/Kconfig"
rsource "opendisplay/Kconfig"
```

## subsys/net/lib/esphome_api/Kconfig
```kconfig
menuconfig ESPHOME_API
	bool "ESPHome native API server"
	depends on NET_SOCKETS
	depends on NET_TCP
	select NANOPB
	help
	  Server side of the ESPHome native API (TCP, protobuf messages,
	  optional Noise encryption, mDNS discovery) so Home Assistant can
	  discover the device and read and control its entities. Only the
	  networking protocol is implemented, not ESPHome's YAML/codegen.

if ESPHOME_API

config ESPHOME_API_PORT
	int "TCP port"
	default 6053

config ESPHOME_API_MAX_CLIENTS
	int "Maximum concurrent clients"
	default 2
	range 1 8

config ESPHOME_API_IDLE_TIMEOUT
	int "Idle timeout in seconds"
	default 90
	help
	  Close a client that has sent nothing for this long. Home Assistant
	  pings every 20 s and gives up on an unanswered ping after 90 s.

config ESPHOME_API_RX_BUF_SIZE
	int "Receive buffer per client"
	default 256
	help
	  Largest request frame accepted. The client requests this server
	  handles are all well under 128 bytes.

config ESPHOME_API_DEVICE_NAME
	string "Device name"
	default "zephyr"
	depends on !NET_HOSTNAME_ENABLE
	help
	  Hostname-style name (at most 31 characters) Home Assistant uses to
	  identify the device. Keep it stable. With NET_HOSTNAME_ENABLE the
	  hostname is used instead, so the name matches <hostname>.local.

config ESPHOME_API_FRIENDLY_NAME
	string "Friendly name"
	default ""

config ESPHOME_API_MANUFACTURER
	string "Manufacturer shown in Home Assistant"
	default "Zephyr"

config ESPHOME_API_MDNS
	bool "Advertise over mDNS"
	default y
	depends on MDNS_RESPONDER_DNS_SD
	help
	  Register an _esphomelib._tcp DNS-SD service, named after the
	  hostname, with the TXT keys Home Assistant's discovery reads
	  (friendly_name, version, mac, board, network). Needs
	  MDNS_RESPONDER, DNS_SD and NET_HOSTNAME_ENABLE.

config ESPHOME_API_NOISE
	bool "Noise encryption"
	select PSA_CRYPTO
	select PSA_WANT_ALG_CHACHA20_POLY1305
	select PSA_WANT_KEY_TYPE_CHACHA20
	select PSA_WANT_ALG_ECDH
	select PSA_WANT_ECC_MONTGOMERY_255
	select PSA_WANT_KEY_TYPE_ECC_KEY_PAIR_GENERATE
	select PSA_WANT_KEY_TYPE_ECC_KEY_PAIR_EXPORT
	select PSA_WANT_ALG_HMAC
	select PSA_WANT_KEY_TYPE_HMAC
	select PSA_WANT_ALG_SHA_256
	select BASE64
	help
	  Encrypt the connection with Noise_NNpsk0_25519_ChaChaPoly_SHA256, as
	  ESPHome's "api: encryption: key:" does. Plaintext clients are
	  refused. Set the 32-byte key with esphome_api_set_psk() (saved to
	  settings when CONFIG_SETTINGS is enabled; call settings_load() at
	  boot) or, for development, ESPHOME_API_NOISE_PSK. Until a key is
	  set every client is refused.

config ESPHOME_API_NOISE_PSK
	string "Encryption key (base64), development only"
	depends on ESPHOME_API_NOISE
	default ""
	help
	  Base64 of the 32-byte key, as Home Assistant asks for it. The key
	  ends up in the firmware image, so use esphome_api_set_psk() for
	  anything beyond development.

config ESPHOME_API_STACK_SIZE
	int "Server thread stack size"
	default 4096 if ESPHOME_API_NOISE
	default 2048

config ESPHOME_API_THREAD_PRIORITY
	int "Server thread priority"
	default 7

module = ESPHOME_API
module-str = esphome_api
source "subsys/logging/Kconfig.template.log_config"

endif # ESPHOME_API
```

## subsys/opendisplay/Kconfig
```kconfig
# SPDX-License-Identifier: Apache-2.0

DT_CHOSEN_ZEPHYR_DISPLAY := zephyr,display

menuconfig OPENDISPLAY
	bool "OpenDisplay device"
	depends on DISPLAY
	depends on $(dt_chosen_enabled,$(DT_CHOSEN_ZEPHYR_DISPLAY))
	select CRC
	help
	  Device side of the OpenDisplay protocol 2.2 (opendisplay.org), so
	  Home Assistant's opendisplay integration or py-opendisplay can read
	  the device config and push images to the zephyr,display device.

if OPENDISPLAY

config OPENDISPLAY_FW_VERSION_MAJOR
	int "Firmware version major"
	range 0 255
	default 1

config OPENDISPLAY_FW_VERSION_MINOR
	int "Firmware version minor"
	range 0 255
	default 0

config OPENDISPLAY_FW_VERSION_PATCH
	int "Firmware version patch"
	range 0 255
	default 0

config OPENDISPLAY_IC_TYPE
	int "SystemConfig ic_type"
	range 0 65535
	default 0
	help
	  Microcontroller id reported to hosts. 0 is "unknown"; hosts only
	  use it for display.

config OPENDISPLAY_MANUFACTURER_ID
	int "ManufacturerData manufacturer_id"
	range 0 65535
	default 0
	help
	  0 is DIY.

config OPENDISPLAY_BOARD_TYPE
	int "ManufacturerData board_type"
	range 0 255
	default 0

config OPENDISPLAY_POWER_MODE
	int "PowerOption power_mode"
	range 1 3
	default 2
	help
	  1 battery, 2 USB, 3 solar.

config OPENDISPLAY_CONFIG_BUF_SIZE
	int "Config buffer size"
	range 660 4096
	default 1024
	help
	  Holds the generated READ_CONFIG reply and a chunked WRITE_CONFIG
	  while it arrives. Larger written configs are refused. A config
	  with WiFi, security and extended identity packets plus the usual
	  hardware packets is about 650 bytes.

config OPENDISPLAY_BLE
	bool "BLE transport"
	depends on BT_PERIPHERAL
	help
	  GATT service 0x2446 with connectable advertising carrying the
	  manufacturer-specific data Home Assistant discovers. Start it with
	  opendisplay_ble_start() after bt_enable(). Hosts write up to 232-byte
	  frames, so the ATT MTU must reach 235: the defaults below raise the
	  ACL buffers and L2CAP MTU to 251/247.

if OPENDISPLAY_BLE

config OPENDISPLAY_BLE_RX_QUEUE
	int "Queued writes"
	default 4
	help
	  Writes waiting for the transport thread, each up to 253 bytes. Hosts
	  wait for the reply to each command, so a few are enough.

config OPENDISPLAY_BLE_STACK_SIZE
	int "Transport thread stack size"
	default 2048

config OPENDISPLAY_BLE_THREAD_PRIORITY
	int "Transport thread priority"
	default 7

endif # OPENDISPLAY_BLE

config OPENDISPLAY_LAN
	bool "LAN transport"
	depends on NET_SOCKETS
	help
	  TCP server for protocol 2.2's network transport: [len:2 LE][frame],
	  one client at a time (a new one evicts the old), dropped when idle.
	  Listens on the port the host wrote in WifiConfig, or
	  OPENDISPLAY_LAN_PORT, as soon as the stack is up. Needs a 4 KB
	  receive buffer: hosts send direct write chunks of 4092 bytes.

if OPENDISPLAY_LAN

config OPENDISPLAY_LAN_PORT
	int "Default TCP port"
	range 1 65534
	default 2446
	help
	  Used while the host-written WifiConfig server_port is 0.

config OPENDISPLAY_LAN_IDLE_TIMEOUT
	int "Idle timeout in seconds"
	default 30

config OPENDISPLAY_LAN_MDNS
	bool "Advertise over mDNS"
	default y
	depends on MDNS_RESPONDER_DNS_SD
	help
	  Register _opendisplay._tcp with TXT keys mac (the BLE address when
	  the BLE transport is on, else the interface MAC), tls, fw, cm and
	  pv. The instance is the hostname with NET_HOSTNAME_ENABLE, else
	  "opendisplay".

config OPENDISPLAY_LAN_STACK_SIZE
	int "Server thread stack size"
	default 4096 if OPENDISPLAY_SECURITY
	default 2048

config OPENDISPLAY_LAN_THREAD_PRIORITY
	int "Server thread priority"
	default 7

endif # OPENDISPLAY_LAN

config OPENDISPLAY_ZLIB
	bool "zlib compressed uploads"
	select UZLIB
	help
	  Accept zlib streams with a window of up to 512 bytes (what hosts
	  send) in direct write and PIPE_WRITE, decoded as they arrive.
	  About 2.8 KB of RAM. Advertised as streaming decompression.

config OPENDISPLAY_PIPE
	bool "PIPE_WRITE uploads"
	help
	  Sliding-window image transfer over BLE (0x0080-0x0082): the host
	  keeps up to 32 frames in flight and the device acknowledges every
	  few. Hosts that see it advertised use it in place of direct write.

config OPENDISPLAY_SECURITY
	bool "Encryption"
	depends on !OPENDISPLAY_LAN || NET_SOCKETS_SOCKOPT_TLS
	select PSA_CRYPTO
	select PSA_WANT_KEY_TYPE_AES
	select PSA_WANT_ALG_CMAC
	select PSA_WANT_ALG_CCM
	select PSA_WANT_ALG_ECB_NO_PADDING
	help
	  Honour the host-written SecurityConfig. While it is enabled with a
	  non-zero key, BLE hosts must pass AUTHENTICATE (0x0050) before any
	  command but FIRMWARE_VERSION, and frames are then AES-128-CCM
	  wrapped. The LAN transport serves only TLS 1.2 PSK on server_port
	  + 1, with identity "opendisplay" and a PSK derived from the key;
	  enable a PSK ciphersuite such as
	  MBEDTLS_CIPHERSUITE_TLS_PSK_WITH_AES_128_GCM_SHA256 for it.

config OPENDISPLAY_LAN_TLS_SEC_TAG
	int "TLS credential tag for the LAN PSK"
	depends on OPENDISPLAY_SECURITY && OPENDISPLAY_LAN
	default 2446

module = OPENDISPLAY
module-str = opendisplay
source "subsys/logging/Kconfig.template.log_config"

endif # OPENDISPLAY

if OPENDISPLAY_BLE

config BT_L2CAP_TX_MTU
	default 247

config BT_BUF_ACL_RX_SIZE
	default 251

config BT_BUF_ACL_TX_SIZE
	default 251

endif # OPENDISPLAY_BLE
```

## tests/drivers/actuator/icl57/testcase.yaml
```yaml
common:
  tags: [actuator, icl57]
tests:
  drivers.actuator.icl57.profile:
    platform_allow: [native_sim]
    integration_platforms: [native_sim]
```

## tests/drivers/adin3310/testcase.yaml
```yaml
tests:
  drivers.ethernet.adin3310:
    tags:
      - drivers
      - ethernet
      - spi
    platform_allow:
      - native_sim
      - qemu_cortex_m3
```

## tests/drivers/arducam_pivariety/testcase.yaml
```yaml
common:
  tags: drivers
  platform_allow:
    - qemu_cortex_m3
    - native_sim
    - waveshare_esp32_s3_eth/esp32s3/procpu/qemu
    - adafruit_qt_py_esp32c3/esp32c3/qemu

tests:
  drivers.video.arducam_pivariety: {}
```

## tests/drivers/dynamixel/testcase.yaml
```yaml
# tests/drivers/dynamixel/testcase.yaml
tests:
  drivers.dynamixel:
    tags:
      - drivers
      - dynamixel
    harness: ztest
    platform_allow:
      - native_sim
  drivers.dynamixel.build_only:
    build_only: true
    tags:
      - drivers
      - dynamixel
    platform_allow:
      - native_sim
    integration_platforms:
      - native_sim
```

## tests/drivers/lan9252/testcase.yaml
```yaml
tests:
  drivers.ethercat.lan9252:
    tags:
      - drivers
      - ethercat
      - spi
    platform_allow:
      - native_sim
      - qemu_cortex_m3
      - waveshare_esp32_s3_eth/esp32s3/procpu/qemu
      - adafruit_qt_py_esp32c3/esp32c3/qemu
```

## tests/drivers/sensor/icm20948/testcase.yaml
```yaml
tests:
  drivers.sensor.icm20948:
    tags:
      - drivers
      - sensor
      - subsys
    platform_allow:
      - native_sim
      - qemu_cortex_m3
```

## tests/drivers/sensor/ina3221/testcase.yaml
```yaml
common:
  tags:
    - drivers
    - sensor
  platform_allow:
    - qemu_cortex_m3
    - native_sim

tests:
  drivers.sensor.ina3221: {}
  drivers.sensor.ina3221.sync_only:
    extra_configs:
      - CONFIG_SENSOR_ASYNC_API=n
```

## tests/drivers/sensor/ltr308/testcase.yaml
```yaml
common:
  tags:
    - drivers
    - sensor
  platform_allow:
    - qemu_cortex_m3
    - native_sim

tests:
  drivers.sensor.ltr308: {}
```

## tests/drivers/video/esp32_i2s_cam/testcase.yaml
```yaml
common:
  tags:
    - drivers
    - video
tests:
  drivers.video.esp32_i2s_cam.jpeg:
    platform_allow:
      - qemu_cortex_m3
      - native_sim
      - native_sim/native/64
    integration_platforms:
      - native_sim
      - native_sim/native/64
  drivers.video.esp32_i2s_cam.build:
    build_only: true
    # The driver uses hal_espressif headers; skipped where that module is absent.
    modules:
      - hal_espressif
    platform_allow:
      - ai_thinker_esp32_cam/esp32/procpu
    extra_configs:
      - CONFIG_VIDEO=y
```

## tests/lib/actuator/state_machine/testcase.yaml
```yaml
common:
  tags:
    - actuator
    - lib
tests:
  lib.actuator.state_machine:
    platform_allow:
      - native_sim
      - waveshare_esp32_s3_eth/esp32s3/procpu/qemu
      - adafruit_qt_py_esp32c3/esp32c3/qemu
```

## tests/lib/cdr/testcase.yaml
```yaml
common:
  tags: [cdr, lib]
tests:
  lib.cdr:
    platform_allow: [native_sim, waveshare_esp32_s3_eth/esp32s3/procpu/qemu, adafruit_qt_py_esp32c3/esp32c3/qemu]
```
