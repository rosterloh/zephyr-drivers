## dts/bindings/sensor/rosterloh,esp32-pcnt.yaml
```yaml
description: |
  ESP32 PCNT pulse-counter block exposing each counting unit as its own
  encoder sensor device.

  Unlike the upstream espressif,esp32-pcnt sensor driver (which only reports
  unit 0), every enabled unit child node here becomes an independent Zephyr
  device, so multiple encoders (e.g. one per wheel) can be read separately.
  Apply this compatible to the SoC's pcnt node in a board dts to replace the
  upstream driver.

  Each unit uses PCNT channel 0 only: the signal input counts edges, the
  control input optionally gates/inverts the count direction. The vendor
  half-quad scheme (ESP32Encoder::attachHalfQuad) is sig-pos-mode = 2,
  sig-neg-mode = 1, ctrl-h-mode = 0, ctrl-l-mode = 1.

  The 16-bit hardware counter wraps at +/-30000 via high/low limit events
  that the driver accumulates into a 64-bit software total. The accumulated
  count is reported on SENSOR_CHAN_ROTATION in degrees, scaled by
  counts-per-revolution.

compatible: "rosterloh,esp32-pcnt"

include: [base.yaml, pinctrl-device.yaml]

child-binding:
  description: PCNT unit configured as an encoder input.

  properties:
    reg:
      type: int
      required: true
      description: PCNT unit index (0..7 on ESP32).

    counts-per-revolution:
      type: int
      required: true
      description: |
        Hardware counts per revolution of the measured shaft, including any
        decode multiplier and gearbox ratio. Used to scale counts to degrees
        for SENSOR_CHAN_ROTATION.

    filter:
      type: int
      default: 0
      description: |
        Glitch filter threshold in APB clock cycles (80 MHz: 800 = 10 us).
        0 disables the filter. Hardware maximum is 1023.

    sig-pos-mode:
      type: int
      default: 1
      enum: [0, 1, 2]
      description: |
        Action on positive edge of the signal input.
        0 = hold, 1 = increment, 2 = decrement.

    sig-neg-mode:
      type: int
      default: 0
      enum: [0, 1, 2]
      description: |
        Action on negative edge of the signal input.
        0 = hold, 1 = increment, 2 = decrement.

    ctrl-h-mode:
      type: int
      default: 0
      enum: [0, 1, 2]
      description: |
        Modifier while the control input is high.
        0 = keep, 1 = invert, 2 = hold.

    ctrl-l-mode:
      type: int
      default: 0
      enum: [0, 1, 2]
      description: |
        Modifier while the control input is low.
        0 = keep, 1 = invert, 2 = hold.
```

## dts/bindings/video/espressif,esp32p4-mipi-csi.yaml
```yaml
# Copyright (c) 2026 Richard Osterloh
# SPDX-License-Identifier: Apache-2.0

description: |
  Espressif ESP32-P4 MIPI CSI-2 camera receiver.

  Drives the CSI-2 D-PHY, host and bridge and a DW-GDMA channel to capture
  frames from a downstream CSI-2 image sensor into memory. The single video
  port describes the CSI-2 link to that sensor.

  Example:

      &mipi_csi {
          status = "okay";
          port {
              csi_ep_in: endpoint {
                  remote-endpoint-label = "imx219_ep_out";
                  bus-type = <VIDEO_BUS_TYPE_CSI2_DPHY>;
                  data-lanes = <1 2>;
              };
          };
      };

compatible: "espressif,esp32p4-mipi-csi"

include: [base.yaml]

properties:
  reg:
    required: true
  reg-names:
    required: true
    description: Must list "host" and "bridge".
  interrupts:
    required: true

child-binding:
  child-binding:
    include: video-interfaces.yaml
    properties:
      bus-type:
        required: true
      data-lanes:
        required: true
```

## dts/bindings/waveshare,bus-servo.yaml
```yaml
description: Waveshare serial bus servo device

compatible: "waveshare,bus-servo"

include: uart-device.yaml

properties:
    tx-en-gpios:
      type: phandle-array
      required: false
      description: Transmit enable pin of the half-duplex transceiver.
```

## lib/actuator/Kconfig
```kconfig
config ACTUATOR_LIB
	bool
	default y if ACTUATOR
	help
	  Pure-logic helpers for the actuator subsystem (state machine,
	  capability matching, unit conversion). No struct device dependencies.
```

## lib/cdr/Kconfig
```kconfig
config CDR
	bool "CDR (Common Data Representation) serialization library"
	help
	  Little-endian CDR codec for encoding and decoding DDS/ROS 2 rmw
	  payloads, as used by zenoh-pico ROS bridges. Provides the primitive
	  layer (scalars, strings, encapsulation header); message layouts are
	  assembled by the application on top.
```

## lib/kinematics/Kconfig
```kconfig
config KINEMATICS
	bool "Kinematics joint-descriptor library"
	select ZCBOR
	help
	  Expose this device's URDF-style joint descriptors (from devicetree)
	  and serialize them to CBOR for a remote controller to assemble a
	  kinematic tree.
```

## samples/actuator/basic/sample.yaml
```yaml
sample:
  name: Actuator basic demo
  description: Single-actuator hello using the generic actuator API.
tests:
  sample.actuator.basic:
    tags: actuator
    platform_allow: native_sim
    build_only: true
```

## subsys/actuator/Kconfig
```kconfig
menuconfig ACTUATOR
	bool "Actuator subsystem"
	help
	  Generic actuator API: typed SI setpoints, group operations,
	  state machine, callback feedback.

if ACTUATOR

config ACTUATOR_INIT_PRIORITY
	int "Actuator subsystem init priority"
	default 90
	help
	  Must be after device drivers (default 50) and before the application.

module = ACTUATOR
module-str = actuator
source "subsys/logging/Kconfig.template.log_config"

config ACTUATOR_MAX_CALLBACKS_PER_DEVICE
	int "Maximum number of callbacks per actuator device"
	default 2
	help
	  Combined limit for state and feedback callbacks per device.
	  Each callback consumes one slot in the device's static slist.

config ACTUATOR_MAX_GROUPS
	int "Maximum number of actuator groups with non-default fault policy"
	default 4
	help
	  Each group registered for fault-policy enforcement consumes one slot
	  in a static array. Groups with default ISOLATE policy do not register.

config ACTUATOR_SHELL
	bool "Actuator subsystem shell"
	depends on SHELL
	help
	  Adds an `actuator` command for inspecting and commanding actuators
	  from the Zephyr shell.

endif # ACTUATOR
```

## subsys/net/wifi_connectivity/Kconfig
```kconfig
menuconfig WIFI_CONNECTIVITY
	bool "conn_mgr connectivity for WiFi using stored credentials"
	depends on NET_CONNECTION_MANAGER_CONNECTIVITY_WIFI_MGMT
	depends on WIFI_CREDENTIALS
	depends on WIFI_CREDENTIALS_CONNECT_STORED
	help
	  Implements the CONNECTIVITY_WIFI_MGMT conn_mgr binding declared by
	  WiFi drivers. Connects with credentials from the wifi_credentials
	  subsystem (NET_REQUEST_WIFI_CONNECT_STORED), starts DHCPv4 once
	  associated and, while the interface is persistent, retries failed
	  attempts and re-establishes lost connections. Supports a single
	  WiFi interface.

if WIFI_CONNECTIVITY

module = WIFI_CONNECTIVITY
module-str = wifi_connectivity
source "subsys/logging/Kconfig.template.log_config"

config WIFI_CONNECTIVITY_PERSISTENCE
	bool "Enable connection persistence by default"
	default y
	help
	  Sets CONN_MGR_IF_PERSISTENT on the bound WiFi interface at init so
	  that lost connections are re-established automatically. Can be
	  changed at runtime with conn_mgr_if_set_flag().

config WIFI_CONNECTIVITY_RECONNECT_DELAY_SECONDS
	int "Delay between reconnect attempts"
	default 5
	help
	  Seconds to wait after a failed connection attempt, an unsolicited
	  disconnect, or a connect issued with no stored credentials before
	  trying NET_REQUEST_WIFI_CONNECT_STORED again.

endif # WIFI_CONNECTIVITY
```

## tests/drivers/actuator/bus_servo/testcase.yaml
```yaml
common:
  tags: [actuator, drivers, bus_servo]
tests:
  drivers.actuator.bus_servo:
    platform_allow: [native_sim]
```

## tests/drivers/actuator/dxl/testcase.yaml
```yaml
common:
  tags: [actuator, drivers]
tests:
  drivers.actuator.dxl:
    platform_allow: [native_sim]
```

## tests/drivers/actuator/hbridge/testcase.yaml
```yaml
common:
  tags: [actuator, drivers]
tests:
  drivers.actuator.hbridge.build_only:
    platform_allow: [native_sim]
    build_only: true
```

## tests/drivers/bus_servo/testcase.yaml
```yaml
tests:
  drivers.bus_servo:
    tags:
      - drivers
      - bus_servo
    harness: ztest
    platform_allow:
      - native_sim
```

## tests/drivers/seesaw/testcase.yaml
```yaml
common:
  tags: drivers
  platform_allow:
    - native_sim

tests:
  drivers.seesaw:
    extra_configs: []

  drivers.seesaw.mfd:
    extra_configs:
      - CONFIG_MFD_ADAFRUIT_SEESAW=y
      - CONFIG_GPIO_ADAFRUIT_SEESAW=y
      - CONFIG_ADC=y
      - CONFIG_ADC_ADAFRUIT_SEESAW=y
      - CONFIG_PWM=y
      - CONFIG_PWM_ADAFRUIT_SEESAW=y
      - CONFIG_LED_STRIP=y
      - CONFIG_LED_STRIP_ADAFRUIT_SEESAW=y
      - CONFIG_SENSOR=y
      - CONFIG_ADAFRUIT_SEESAW_ENCODER=y
```

## tests/drivers/sensor/as7341/testcase.yaml
```yaml
tests:
  drivers.sensor.as7341:
    tags:
      - drivers
      - sensor
      - subsys
    platform_allow:
      - native_sim
```

## tests/lib/actuator/capabilities/testcase.yaml
```yaml
common:
  tags: [actuator, lib]
tests:
  lib.actuator.capabilities:
    platform_allow: [native_sim]
```
